/dts-v1/;

/ {
	fragment@0 {
		target = <0xffffffff>;
		__overlay__ {
			atag,videolfb-fb_base_l = "~`P";
			atag,videolfb-fb_base_h = <0x0>;
			atag,videolfb-islcmfound = <0x1>;
			atag,videolfb-islcm_inited = <0x0>;
			atag,videolfb-fps = <0x1770>;
			atag,videolfb-vramSize = <0x1be0000>;
			atag,videolfb-lcmname = "nt35595_fhd_dsi_cmd_truly_nt50358_drv";
		};
	};
	fragment@1 {
		target = <0xffffffff>;
		__overlay__ {
			mt6360,intr_gpio_num = <0xa>;
			mt6360,intr_gpio = <0xffffffff 0xa 0x0>;
		};
	};
	fragment@2 {
		target = <0xffffffff>;
		__overlay__ {
			pwr-off-seq = <0x4000002>;
		};
	};
	fragment@3 {
		target = <0xffffffff>;
		__overlay__ {
			mt6360pd,intr-gpio-num = <0x9>;
			mt6360pd,intr-gpio = <0xffffffff 0x9 0x0>;
			pd-data {
				pd,source-pdo-size = <0x2>;
				pd,source-pdo-data = <0x19032 0x190c8>;
			};
		};
	};
	fragment@4 {
		target = <0xffffffff>;
		__overlay__ {
			aw87xxx_pa@58 {
				compatible = "awinic,aw87xxx_pa";
				reg = <0x58>;
				dev_index = <0x1>;
				status = "okay";
			};
			aw87xxx_pa@59 {
				compatible = "awinic,aw87xxx_pa";
				reg = <0x59>;
				dev_index = <0x0>;
				status = "okay";
			};
		};
	};
	fragment@5 {
		target = <0xffffffff>;
		__overlay__ {
			tran_audio_controller {
				compatible = "tran-audio-controller";
				tran_pa_type = <0x2>;
				phandle = <0x49>;
			};
			tran_audio {
				compatible = "tran_audio,audio";
				phandle = <0x4a>;
			};
		};
	};
	fragment@6 {
		target = <0xffffffff>;
		__overlay__ {
			lcm_rst_out1_gpio {
				phandle = <0x1>;
				pins_cmd_dat {
					pinmux = <0x5600>;
					slew-rate = <0x1>;
					output-high;
				};
			};
			lcm_rst_out0_gpio {
				phandle = <0x2>;
				pins_cmd_dat {
					pinmux = <0x5600>;
					slew-rate = <0x1>;
					output-low;
				};
			};
			lcm_dsi_te {
				phandle = <0x3>;
				pins_cmd_dat {
					pinmux = <0x5401>;
				};
			};
			6382_rst_out1_gpio {
				phandle = <0x4>;
				pins_cmd_dat {
					pinmux = <0x1100>;
					slew-rate = <0x1>;
					output-high;
				};
			};
			6382_rst_out0_gpio {
				phandle = <0x5>;
				pins_cmd_dat {
					pinmux = <0x1100>;
					slew-rate = <0x1>;
					output-low;
				};
			};
		};
	};
	fragment@7 {
		target = <0xffffffff>;
		__overlay__ {
			pinctrl-names = "lcm_rst_out1_gpio", "lcm_rst_out0_gpio", "mode_te_te", "6382_rst_out1_gpio", "6382_rst_out0_gpio";
			pinctrl-0 = <0x1>;
			pinctrl-1 = <0x2>;
			pinctrl-2 = <0x3>;
			pinctrl-3 = <0x4>;
			pinctrl-4 = <0x5>;
			status = "okay";
		};
	};
	fragment@8 {
		target = <0xffffffff>;
		__overlay__ {
			pinctrl-names = "lcm_rst_out1_gpio", "lcm_rst_out0_gpio", "mode_te_te";
			pinctrl-0 = <0x1>;
			pinctrl-1 = <0x2>;
			pinctrl-2 = <0x3>;
			status = "okay";
			helper-value = <0x0 0x1 0x1 0x1 0x1 0x0 0x1 0x0 0x0 0x0 0x0 0x0 0x1 0x0 0x1 0x1 0x1 0x1 0x1 0x0 0x1 0x1 0x0 0x1 0x0 0x1 0x0 0x0 0x0 0x0 0x1 0x0 0x0 0x0 0x0 0x0 0x1 0x0 0x0 0x1 0x0 0x0 0x0 0x0 0x0 0x1 0x0>;
		};
	};
	fragment@9 {
		target = <0xffffffff>;
		__overlay__ {
			status = "okay";
			#address-cells = <0x1>;
			#size-cells = <0x0>;
			bdg-gpios = <0xffffffff 0x11 0x0>;
			panel1@0 {
				compatible = "nt37703a,fhdp,dsi,vdo,tm,tm,li9";
				reg = <0x0>;
				dvdd-gpios = <0xffffffff 0x46 0x0>;
				vci-gpios = <0xffffffff 0x2f 0x0>;
				reset-gpios = <0xffffffff 0x56 0x0>;
				doze_backlight = <0x3 0x5 0x7 0x1f>;
				pinctrl-names = "default";
				port {
					endpoint {
						remote-endpoint = <0x6>;
						phandle = <0x7>;
					};
				};
			};
			ports {
				port {
					endpoint {
						remote-endpoint = <0x7>;
						phandle = <0x6>;
					};
				};
			};
		};
	};
	fragment@10 {
		target = <0xffffffff>;
		__overlay__ {
			pwm_ch = <0x3>;
			ldo-gpio = <0xffffffff 0x27 0x0>;
			status = "okay";
		};
	};
	fragment@11 {
		target = <0xffffffff>;
		__overlay__ {
			compatible = "mediatek,disp-leds";
			backlight {
				led_mode = <0x4>;
				pwm-names = "lcd-backlight";
				pwm_config = <0x0 0x1 0x0 0x0 0x0>;
				max-brightness = <0x1ff>;
				max-hw-brightness = <0x1ff>;
			};
		};
	};
	fragment@12 {
		target = <0xffffffff>;
		__overlay__ {
			status = "okay";
			#address-cells = <0x1>;
			#size-cells = <0x0>;
			pinctrl-names = "default";
			pinctrl-0 = <0x8>;
			spislv@0 {
				compatible = "mediatek,spi_slave";
				reg = <0x0>;
				spi-max-frequency = <0x3473bc0>;
				spi-tx-bus-width = <0x1>;
				spi-rx-bus-width = <0x1>;
				low-speed-tick-delay = [04];
				low-speed-early-trans = [00];
				high-speed-tick-delay = [01];
				high-speed-early-trans = [00];
				slave-drive-strength = [03];
			};
		};
	};
	fragment@13 {
		target = <0xffffffff>;
		__overlay__ {
			clock-frequency = <0x61a80>;
			status = "okay";
			nfc_nxp@28 {
				compatible = "nxp,pn544";
				reg = <0x28>;
				nxp,pn544-irq = <0xffffffff 0x5 0x0>;
				nxp,pn544-ven = <0xffffffff 0x5c 0x0>;
			};
			irq_nfc {
				compatible = "mediatek,irq_nfc-eint";
				interrupt-parent = <0xffffffff>;
				interrupts = <0x5 0x4>;
				status = "okay";
				phandle = <0x4b>;
			};
		};
	};
	fragment@14 {
		target = <0xffffffff>;
		__overlay__ {
			spislv_mode_default {
				phandle = <0x8>;
				pins_cmd_dat {
					pinmux = <0x2601 0x2401 0x2501 0x2301>;
					drive-strength = <0x3>;
				};
			};
		};
	};
	fragment@15 {
		target = <0xffffffff>;
		__overlay__ {
			compatible = "mediatek,disp,bdg_enabled";
			bdg_rxtx_ratio = <0xe5>;
		};
	};
	fragment@16 {
		target = <0xffffffff>;
		__overlay__ {
			mediatek,hw-init-map = <0x73 0x72 0x0 0x0 0x0 0x0 0x0 0x0 0x0 0x0 0x0 0x0 0x0 0x0 0x0 0x0 0x0 0x0 0x0 0x0 0x0 0x0 0x0 0x0 0x0 0x0 0x0 0x0 0x0 0x0 0x0 0x0 0x0 0x0 0x0 0x0 0x0 0x0 0x0 0x0 0x0 0x0 0x0 0x0 0x0 0x0 0x0 0x0 0x0 0x0 0x0 0x0 0x0 0x0 0x0 0x0 0x0 0x0 0x0 0x0 0x0 0x0 0x0 0x0 0x0 0x0 0x0 0x0 0x0 0x0 0x0 0x0>;
			pinctrl-names = "default";
			pinctrl-0 = <0x9>;
			status = "okay";
		};
	};
	fragment@17 {
		target = <0xffffffff>;
		__overlay__ {
			kpdgpiodefault {
				phandle = <0x9>;
				pins_cmd_dat {
					pinmux = <0x4f01>;
					bias-pull-up = <0x66>;
					output-low;
					input-schmitt-enable;
				};
			};
		};
	};
	fragment@18 {
		target = <0xffffffff>;
		__overlay__ {
			accdet-mic-vol = <0x8>;
			headset-mode-setting = <0x500 0x500 0x1 0x1f0 0x800 0x800 0x20 0x44 0x4 0x1 0x5 0x3 0x3 0x5 0xe>;
			accdet-plugout-debounce = <0x1>;
			accdet-mic-mode = <0x2>;
			headset-three-key-threshold = <0x0 0x50 0xdc 0x190>;
			headset-three-key-threshold-CDD = <0x0 0x79 0xc0 0x258>;
			headset-four-key-threshold = <0x0 0x3a 0x79 0xc0 0x190>;
			eint_use_ext_res = <0x0>;
			status = "okay";
		};
	};
	fragment@19 {
		target = <0xffffffff>;
		__overlay__ {
			led@0 {
				compatible = "mediatek,red";
				led_mode = <0x0>;
				data = <0x1>;
				pwm_config = <0x0 0x0 0x0 0x0 0x0>;
				phandle = <0x4c>;
			};
			led@1 {
				compatible = "mediatek,green";
				led_mode = <0x0>;
				data = <0x1>;
				pwm_config = <0x0 0x0 0x0 0x0 0x0>;
				phandle = <0x4d>;
			};
			led@2 {
				compatible = "mediatek,blue";
				led_mode = <0x0>;
				data = <0x1>;
				pwm_config = <0x0 0x0 0x0 0x0 0x0>;
				phandle = <0x4e>;
			};
			led@3 {
				compatible = "mediatek,jogball-backlight";
				led_mode = <0x0>;
				data = <0x1>;
				pwm_config = <0x0 0x0 0x0 0x0 0x0>;
				phandle = <0x4f>;
			};
			led@4 {
				compatible = "mediatek,keyboard-backlight";
				led_mode = <0x0>;
				data = <0x1>;
				pwm_config = <0x0 0x0 0x0 0x0 0x0>;
				phandle = <0x50>;
			};
			led@5 {
				compatible = "mediatek,button-backlight";
				led_mode = <0x0>;
				data = <0x1>;
				pwm_config = <0x0 0x0 0x0 0x0 0x0>;
				phandle = <0x51>;
			};
			led@6 {
				compatible = "mediatek,lcd-backlight";
				led_mode = <0x4>;
				data = <0x1>;
				pwm_config = <0x0 0x1 0x0 0x0 0x0>;
				phandle = <0x52>;
			};
			vibrator@0 {
				compatible = "mediatek,vibrator";
				vib_timer = <0x19>;
				vib_limit = <0x9>;
				vib_vol = <0x9>;
				phandle = <0x53>;
			};
			fingerprint {
				compatible = "tran_fp";
				interrupt-parent = <0xffffffff>;
				interrupts = <0x1b 0x1 0x1b 0x0>;
				debounce = <0x1b 0x0>;
				pinctrl-names = "tran_fp_default", "tran_fp_pin_irq", "tran_fp_irq_pull_down", "tran_fp_reset_high", "tran_fp_reset_low";
				pinctrl-0 = <0xa>;
				pinctrl-1 = <0xb>;
				pinctrl-2 = <0xc>;
				pinctrl-3 = <0xd>;
				pinctrl-4 = <0xe>;
				status = "okay";
				phandle = <0x54>;
			};
		};
	};
	fragment@20 {
		target = <0xffffffff>;
		__overlay__ {
			fingerprint@0 {
				compatible = "tran_fp";
				reg = <0x0>;
				spi-max-frequency = <0x2160ec0>;
				interrupt-parent = <0xffffffff>;
				interrupts = <0x1b 0x1 0x1b 0x0>;
				debounce = <0x1b 0x0>;
				irq-gpio = <0x1b>;
				irq-gpio-std = <0xffffffff 0x1b 0x0>;
				reset-gpio = <0x1c>;
				reset-gpio-std = <0xffffffff 0x1c 0x0>;
				vmch-supply = <0xffffffff>;
				goodix;
				pinctrl-names = "tran_fp_default", "tran_fp_pin_irq", "tran_fp_irq_pull_down", "tran_fp_reset_high", "tran_fp_reset_low", "tran_fp_spi_default";
				pinctrl-0 = <0xa>;
				pinctrl-1 = <0xb>;
				pinctrl-2 = <0xc>;
				pinctrl-3 = <0xd>;
				pinctrl-4 = <0xe>;
				pinctrl-5 = <0xf>;
				status = "okay";
			};
		};
	};
	fragment@21 {
		target = <0xffffffff>;
		__overlay__ {
			fingerprint_default {
				phandle = <0xa>;
			};
			gpio9_eint {
				phandle = <0xb>;
				pins_cmd_dat {
					pinmux = <0x1b00>;
					slew-rate = <0x0>;
					bias-disable;
				};
			};
			gpio9_eint_pull_down {
				phandle = <0xc>;
				pins_cmd_dat {
					pinmux = <0x1b00>;
					slew-rate = <0x0>;
					bias-pull-down = <0x0>;
					output-low;
				};
			};
			rst_out_one {
				phandle = <0xd>;
				pins_cmd_dat {
					pinmux = <0x1c00>;
					slew-rate = <0x1>;
					bias-disable;
					output-high;
				};
			};
			rst_out_zero {
				phandle = <0xe>;
				pins_cmd_dat {
					pinmux = <0x1c00>;
					slew-rate = <0x1>;
					bias-disable;
					output-low;
				};
			};
			spimode_default {
				phandle = <0xf>;
				pins_cmd_dat {
					pinmux = <0x1801 0x1901 0x1a01 0x1701>;
					drive-strength = <0x7>;
				};
			};
		};
	};
	fragment@22 {
		target = <0xffffffff>;
		__overlay__ {
			gps_default {
				phandle = <0x10>;
			};
			gps_l1_lna@0 {
				phandle = <0x11>;
				pins_cmd_dat {
					pinmux = <0x5700>;
					output-low;
				};
			};
			gps_l1_lna@1 {
				phandle = <0x12>;
				pins_cmd_dat {
					pinmux = <0x5702>;
				};
			};
			gps_l1_lna@2 {
				phandle = <0x13>;
				pins_cmd_dat {
					pinmux = <0x5700>;
					output-high;
				};
			};
			gps_l5_lna@0 {
				phandle = <0x14>;
				pins_cmd_dat {
					pinmux = <0x5b00>;
					output-low;
				};
			};
			gps_l5_lna@1 {
				phandle = <0x15>;
				pins_cmd_dat {
					pinmux = <0x5b04>;
				};
			};
			gps_l5_lna@2 {
				phandle = <0x16>;
				pins_cmd_dat {
					pinmux = <0x5b00>;
					output-high;
				};
			};
		};
	};
	fragment@23 {
		target = <0xffffffff>;
		__overlay__ {
			pinctrl-names = "default", "gps_l1_lna_disable", "gps_l1_lna_dsp_ctrl", "gps_l1_lna_enable", "gps_l5_lna_disable", "gps_l5_lna_dsp_ctrl", "gps_l5_lna_enable";
			pinctrl-0 = <0x10>;
			pinctrl-1 = <0x11>;
			pinctrl-2 = <0x12>;
			pinctrl-3 = <0x13>;
			pinctrl-4 = <0x14>;
			pinctrl-5 = <0x15>;
			pinctrl-6 = <0x16>;
			status = "okay";
		};
	};
	fragment@24 {
		target = <0xffffffff>;
		__overlay__ {
			usb_control {
				compatible = "transsion, usb_control";
				status = "okay";
				tc30_control_type = <0x2>;
				hvdcp20_control_type = <0x1>;
				rfc_control_type = <0x1>;
				ta_control_type = <0x1>;
				pinctrl-names = "default", "hvdcp_handshake", "hvdcp_boost_5v", "hvdcp_boost_9v", "hvdcp_reset", "tc30_handshake", "tc30_reset", "rfc_i2c_mode", "rfc_dual_high", "rfc_high_low", "rfc_reset", "rfc_usb_switch_on", "rfc_usb_switch_off", "ta_off", "ta_reset";
				pinctrl-0 = <0x17>;
				pinctrl-1 = <0x18>;
				pinctrl-2 = <0x19>;
				pinctrl-3 = <0x1a>;
				pinctrl-4 = <0x1b>;
				pinctrl-5 = <0x1c>;
				pinctrl-6 = <0x1d>;
				pinctrl-7 = <0x1e>;
				pinctrl-8 = <0x1f>;
				pinctrl-9 = <0x20>;
				pinctrl-10 = <0x21>;
				pinctrl-11 = <0x22>;
				pinctrl-12 = <0x23>;
				pinctrl-13 = <0x24>;
				pinctrl-14 = <0x25>;
				phandle = <0x55>;
			};
		};
	};
	fragment@25 {
		target = <0xffffffff>;
		__overlay__ {
			usb_control_default {
				phandle = <0x17>;
			};
			hvdcp_handshake {
				phandle = <0x18>;
			};
			hvdcp_boost_5v {
				phandle = <0x19>;
			};
			hvdcp_boost_9v {
				phandle = <0x1a>;
			};
			hvdcp_reset {
				phandle = <0x1b>;
			};
			tc30_handshake {
				phandle = <0x1c>;
				pins_cmd0_dat {
					pinmux = <0x8c00>;
					slew-rate = <0x1>;
					output-high;
				};
				pins_cmd1_dat {
					pinmux = <0x8900>;
					slew-rate = <0x1>;
					output-high;
				};
			};
			tc30_reset {
				phandle = <0x1d>;
				pins_cmd0_dat {
					pinmux = <0x8c00>;
					slew-rate = <0x1>;
					output-low;
				};
				pins_cmd1_dat {
					pinmux = <0x8900>;
					slew-rate = <0x1>;
					output-low;
				};
			};
			rfc_i2c_mode {
				phandle = <0x1e>;
			};
			rfc_dual_high {
				phandle = <0x1f>;
			};
			rfc_high_low {
				phandle = <0x20>;
			};
			rfc_reset {
				phandle = <0x21>;
			};
			usb_switch_on {
				phandle = <0x22>;
			};
			usb_switch_off {
				phandle = <0x23>;
			};
			ta_off {
				phandle = <0x24>;
				pins_cmd0_dat {
					pinmux = <0x8800>;
					slew-rate = <0x1>;
					output-high;
				};
				pins_cmd1_dat {
					pinmux = <0x8c00>;
					slew-rate = <0x1>;
					output-high;
				};
			};
			ta_reset {
				phandle = <0x25>;
				pins_cmd0_dat {
					pinmux = <0x8800>;
					slew-rate = <0x1>;
					output-low;
				};
				pins_cmd1_dat {
					pinmux = <0x8c00>;
					slew-rate = <0x1>;
					output-low;
				};
			};
		};
	};
	fragment@26 {
		target = <0xffffffff>;
		__overlay__ {
			charge_transfer {
				compatible = "transsion, charge_transfer";
				status = "okay";
				manual_scheme = <0x0>;
				phandle = <0x56>;
			};
			tran_otg {
				compatible = "tran,otg_fun";
				status = "okay";
				pd_reverse_chg_support;
				otg_revercharge_limit_temp = <0x2d>;
				tc_otg_boost_curr_max = <0x1e8480>;
				tc_otg_boost_curr_min = <0x7a120>;
				otg_reverse_chg_curr_lmt = <0x7a120>;
				otg_reverse_chg_limit_temp_step1 = <0x2a>;
				otg_reverse_chg_recovery_area = <0x3>;
				phandle = <0x57>;
			};
			tc_audio {
				compatible = "tc_audio";
				status = "okay";
				water_detect = <0x26>;
				phandle = <0x58>;
			};
			water_detect {
				status = "okay";
				compatible = "transsion, water_detect";
				bootmode = <0xffffffff>;
				polling_interval = <0x5>;
				scheme = <0x0>;
				phandle = <0x26>;
			};
			tc_chgtype {
				compatible = "tc_chgtype";
				charger = <0xffffffff>;
				phys = <0xffffffff 0x3>;
				phy-names = "usb2-phy";
				usb = <0xffffffff>;
				status = "okay";
				phandle = <0x27>;
			};
			tc_pmic {
				compatible = "tc_pmic";
				status = "okay";
				phandle = <0x59>;
			};
			tc_gauge {
				compatible = "tc_gauge";
				gauge = <0xffffffff>;
				status = "okay";
				phandle = <0x5a>;
			};
			tc_misc {
				compatible = "tc,misc_intf";
				bootmode = <0xffffffff>;
				det_ibus_by_swchg;
				io-channels = <0xffffffff 0x6>;
				io-channel-names = "tusb";
				tusb_div_res = <0x186a0>;
				tusb_div_vol = <0x730>;
				min_tusb_temp = <0xffffff38>;
				max_tusb_temp = <0x258>;
				phandle = <0x5b>;
			};
			tc_lcd {
				compatible = "tc,lcd";
				phandle = <0x5c>;
			};
			tc_pe2 {
				compatible = "transsion,pe20_charger";
				status = "okay";
				ta_ichg_level_threshold = <0xf4240>;
				ta_stop_battery_soc = <0x5a>;
				vbat_threshold = <0x426030>;
				chr_volt = <0x4c4b40 0x895440>;
				chr_volt_mivr = <0x4630c0 0x7a1200>;
				chr_volt_input_cur = <0x1e8480 0x1e8480>;
				chr_volt_chg_cur = <0x1e8480 0x36ee80>;
				phandle = <0x5d>;
			};
			tc_30 {
				compatible = "transsion,tc30_charger";
				status = "okay";
				ta_ichg_level_threshold = <0xf4240>;
				ta_stop_battery_soc = <0x5a>;
				vbat_threshold = <0x426030>;
				recover_7v5_gap = <0x7a120>;
				chr_volt = <0x4c4b40 0x7270e0 0x4c4b40 0x7270e0>;
				chr_volt_mivr = <0x4630c0 0x663be0 0x4630c0 0x663be0>;
				chr_volt_input_cur = <0x1e8480 0x249f00 0x1e8480 0x249f00>;
				chr_volt_chg_cur = <0x1e8480 0x36ee80 0x1e8480 0x36ee80>;
				phandle = <0x5e>;
			};
			tc_hvdcp20 {
				compatible = "transsion,hvdcp20_charger";
				status = "okay";
				ta_ichg_level_threshold = <0xf4240>;
				ta_stop_battery_soc = <0x5a>;
				vbat_threshold = <0x426030>;
				recover_9v_gap = <0x7a120>;
				chr_volt = <0x4c4b40 0x895440 0x4c4b40 0x895440>;
				chr_volt_mivr = <0x4630c0 0x7a1200 0x4630c0 0x7a1200>;
				chr_volt_input_cur = <0x1e8480 0x1e8480 0x1e8480 0x1e8480>;
				chr_volt_chg_cur = <0x1e8480 0x36ee80 0x1e8480 0x36ee80>;
				phandle = <0x5f>;
			};
			tc_pd {
				compatible = "transsion,pd_charger";
				status = "okay";
				min_charger_voltage = <0x4630c0>;
				charger_current_limit = <0x36ee80>;
				pd_vbus_upper_bound = <0x989680>;
				pd_vbus_low_bound = <0x4c4b40>;
				ta_ichg_level_threshold = <0xf4240>;
				pd_stop_battery_soc = <0x5a>;
				vbat_threshold = <0x426030>;
				phandle = <0x60>;
			};
			tc_auto_test {
				compatible = "tc,auto_test";
				status = "okay";
				phandle = <0x61>;
			};
			pid_chg {
				compatible = "tc,pid_chg_algo";
				pid_array = <0x3e8 0x64 0x2710>;
				polling_interval = <0x2710>;
				ambient_temp = <0xfa 0xfa 0xfa 0xfa 0x15e>;
				target_temp_array = <0xfa0 0xfa0 0xfa0 0xfa0 0x10cc>;
				power_level = <0x320 0x640 0x960 0xc80 0xfa0>;
				power_delta_temp = <0x0 0x64 0xc8 0x12c 0x12c>;
				power_update_time = <0x12c>;
				power_meas_current = <0x61a80>;
				target_temp_gap = <0x32>;
				steady_cycle = <0x2>;
				max_steady_target_delta_temp = <0x32>;
				max_steady_delta_temp = <0x1e>;
				normal_steady_delta_temp = <0x14>;
				max_unsteady_cnt = <0x2>;
				max_target_temp = <0x1130>;
				ibus_measure_power_update_time = <0x3c>;
				delta_current_max = <0x7a120>;
				phandle = <0x62>;
			};
			ambient_detect {
				compatible = "tc,ambient_detect";
				qmax = <0x1324>;
				polling_interval = <0x1a4>;
				ambient_max_power = <0x8ca>;
				ambient_max_temp = <0x258>;
				ambient_min_temp = <0xffffff38>;
				min_detection_duration = <0x12c>;
				ambient_low_power_update_time = <0x4b0>;
				ambient_charging_time = <0x12c>;
				ambient_cooling_time = <0x258>;
				ambient_max_update_time = <0x2a30>;
				ambient_max_temp_rate = <0x384>;
				ambient_max_diff_pcb_temp = <0x32>;
				min_update_soc_diff = <0x28>;
				plug_update_soc_diff = <0x14>;
				power_level = <0x190 0x320 0x4b0 0x640 0x7d0>;
				power_delta_temp = <0x0 0xa 0x14 0x1e 0x28>;
				phandle = <0x63>;
			};
			temp_forecast {
				compatible = "tc,temp_forecast";
				orgin_rate = <0x64>;
				max_temp_diff = <0x96>;
				max_comp_temp = <0x1e>;
				pa_temp_gap = <0x1f4>;
				per_rate_time = <0x5>;
				phandle = <0x64>;
			};
			pe5 {
				compatible = "tc,pe5";
				status = "okay";
				gauge = <0xffffffff>;
				tc_chgtype = <0x27>;
				polling_interval = <0x1f4>;
				ta_cv_ss_repeat_tmin = <0x19>;
				vbat_cv = <0x11b2>;
				start_vbat_min = <0xbb8>;
				start_vbat_max = <0x1130>;
				idvchg_term = <0x1f4>;
				idvchg_pps_term = <0x4b0>;
				rcable_level = <0x12c 0x15e 0x1c2 0x258>;
				ita_level = <0x1b58 0x1388 0x11f8 0xcb2>;
				idvchg_level_multi = <0xce4 0x1b58 0x1b58 0x1b58>;
				idvchg_ss_init = <0x3e8>;
				idvchg_ss_step = <0xfa>;
				idvchg_ss_step1 = <0x64>;
				idvchg_ss_step2 = <0x32>;
				idvchg_ss_step1_vbat = <0xfa0>;
				idvchg_ss_step2_vbat = <0x1068>;
				ta_blanking = <0x190>;
				chg_time_max = <0x8ca0>;
				tta_level_def = <0x0 0x0 0x0 0x5 0x19 0x19 0x19 0x19 0x19 0x19 0x19 0x19 0x19 0x19 0x50 0x55 0x7d0>;
				tta_curlmt = <0xffffffff 0xffffffff 0xffffffff 0x0 0x0 0x0 0x0 0x0 0x0 0x0 0x0 0x0 0x0 0x0 0x258 0x384 0xffffffff>;
				tta_recovery_area = <0x1>;
				tdvchg_level_def = <0x0 0x0 0x0 0x5 0x19 0x19 0x19 0x19 0x19 0x19 0x19 0x19 0x19 0x19 0x4b 0x50 0xaa>;
				tdvchg_curlmt = <0xffffffff 0xffffffff 0xffffffff 0x0 0x0 0x0 0x0 0x0 0x0 0x0 0x0 0x0 0x0 0x0 0x258 0x384 0xffffffff>;
				tdvchg_recovery_area = <0x1>;
				tbat_level_def = <0xa 0xa 0xa 0x16 0x19 0x19 0x19 0x19 0x19 0x19 0x19 0x19 0x29 0x2a 0x2b 0x2d 0x2e>;
				tbat_curlmt = <0xffffffff 0xffffffff 0x0 0x0 0x0 0x0 0x0 0x0 0x0 0x0 0x0 0x0 0x578 0x7d0 0xfa0 0x1388 0xffffffff>;
				tbat_recovery_area = <0x1>;
				tpcb_level_def = <0x0 0x0 0x0 0x16 0x19 0x19 0x19 0x19 0x29 0x2a 0x2b 0x2c 0x2d 0x2e 0x2f 0x30 0x5a>;
				tpcb_curlmt = <0xffffffff 0xffffffff 0x0 0x0 0x0 0x0 0x0 0x0 0x3e8 0x898 0xbb8 0xd48 0xed8 0x1130 0x1388 0x1388 0xffffffff>;
				tpcb_recovery_area = <0x1>;
				tpa_level_def = <0x0 0x0 0x0 0x16 0x19 0x19 0x19 0x19 0x29 0x2a 0x2b 0x2c 0x2d 0x2e 0x2f 0x30 0x5a>;
				tpa_curlmt = <0xffffffff 0xffffffff 0x0 0x0 0x0 0x0 0x0 0x0 0x3e8 0x898 0xbb8 0xd48 0xed8 0x1130 0x1388 0x1388 0xffffffff>;
				tpa_recovery_area = <0x1>;
				supprot_multi_level_charging;
				tbat_level_def_0 = <0xa 0xa 0xa 0xf 0x19 0x26 0x27 0x28 0x29 0x2a 0x2b 0x2c 0x2c 0x2c 0x2c 0x2d 0x2e>;
				tbat_curlmt_0 = <0xffffffff 0xffffffff 0x0 0x0 0x0 0x0 0x4b0 0x898 0x898 0xa28 0xa28 0x1130 0x1130 0x1130 0x1130 0x1130 0xffffffff>;
				tbat_level_def_1 = <0xa 0xa 0xa 0x16 0x19 0x20 0x21 0x22 0x23 0x24 0x25 0x26 0x27 0x28 0x2a 0x2c 0x2e>;
				tbat_curlmt_1 = <0xffffffff 0xffffffff 0x0 0x0 0x0 0x0 0x0 0x3e8 0x7d0 0x7d0 0xaf0 0xc80 0xe10 0xfa0 0x1130 0x1388 0xffffffff>;
				tbat_level_def_2 = <0xa 0xa 0xa 0x16 0x19 0x21 0x22 0x23 0x24 0x25 0x26 0x27 0x28 0x29 0x29 0x29 0x2e>;
				tbat_curlmt_2 = <0xffffffff 0xffffffff 0x0 0x0 0x0 0x0 0xc80 0xc80 0xed8 0xed8 0xed8 0x1388 0x1388 0x1388 0x1388 0x1388 0xffffffff>;
				tpcb_level_def_0 = <0x0 0x0 0x0 0x16 0x19 0x26 0x27 0x28 0x29 0x2a 0x2b 0x2c 0x2d 0x2e 0x2f 0x2f 0x5a>;
				tpcb_curlmt_0 = <0xffffffff 0xffffffff 0x0 0x0 0x0 0x0 0x0 0x320 0x4b0 0x7d0 0x7d0 0xa28 0xfa0 0x11f8 0x1388 0x1388 0xffffffff>;
				tpcb_level_def_1 = <0x0 0x0 0x0 0x16 0x19 0x21 0x22 0x23 0x24 0x25 0x26 0x27 0x28 0x29 0x2a 0x2c 0x5a>;
				tpcb_curlmt_1 = <0xffffffff 0xffffffff 0x0 0x0 0x0 0x0 0x0 0x0 0x3e8 0x7d0 0xaf0 0xc80 0xe10 0xfa0 0x1130 0x1388 0xffffffff>;
				tpcb_level_def_2 = <0x0 0x0 0x0 0x16 0x19 0x21 0x22 0x23 0x24 0x25 0x26 0x27 0x28 0x29 0x29 0x29 0x5a>;
				tpcb_curlmt_2 = <0xffffffff 0xffffffff 0x0 0x0 0x0 0xbb8 0xbb8 0xbb8 0x1068 0x1068 0x1068 0x11f8 0x11f8 0x1388 0x1388 0x1388 0xffffffff>;
				tpa_level_def_0 = <0x0 0x0 0x0 0x16 0x19 0x19 0x19 0x19 0x26 0x28 0x2b 0x2c 0x2d 0x2e 0x2f 0x30 0x5a>;
				tpa_curlmt_0 = <0xffffffff 0xffffffff 0x0 0x0 0x0 0x0 0x0 0x0 0x5dc 0x7d0 0xa28 0xc80 0xed8 0x1130 0x1388 0x1388 0xffffffff>;
				tpa_level_def_1 = <0x0 0x0 0x0 0x16 0x19 0x19 0x19 0x19 0x26 0x28 0x2b 0x2c 0x2d 0x2e 0x2f 0x30 0x5a>;
				tpa_curlmt_1 = <0xffffffff 0xffffffff 0x0 0x0 0x0 0x0 0x0 0x0 0x5dc 0x7d0 0xa28 0xc80 0xed8 0x1130 0x1388 0x1388 0xffffffff>;
				tpa_level_def_2 = <0x0 0x0 0x0 0x16 0x19 0x19 0x19 0x19 0x26 0x28 0x2b 0x2c 0x2d 0x2e 0x2f 0x30 0x5a>;
				tpa_curlmt_2 = <0xffffffff 0xffffffff 0x0 0x0 0x0 0x0 0x0 0x0 0x5dc 0x7d0 0xa28 0xc80 0xed8 0x1130 0x1388 0x1388 0xffffffff>;
				sys_power_level_def = <0x0 0x0 0x190 0x258 0x2bc 0x320 0x4b0 0x640 0x7d0 0x960 0xaf0 0xc80 0xe10 0xfa0 0x1130 0x12c0 0xc350>;
				sys_power_curlmt = <0xffffffff 0xffffffff 0x0 0x0 0x0 0x7d0 0x640 0x4b0 0x384 0x2bc 0x2bc 0x2bc 0x2bc 0x2bc 0x2bc 0x2bc 0xffffffff>;
				sys_power_recovery_area = <0x190>;
				ifod_threshold = <0xc8>;
				rsw_min = <0x14>;
				ircmp_rbat = <0x28>;
				ircmp_vclamp = <0x0>;
				support_ta = "tfcp_adapter", "pd_adapter";
				allow_not_check_ta_status;
				vbat_threshold = <0x1036>;
				rechg_tbat_high = <0x2b>;
				rechg_tbat_low = <0xc>;
				project_pwr_ratio = <0x46>;
				project_power = <0x46>;
				min_ita_gap = <0xa>;
				ita_stable_cnt = <0x14>;
				vol_diff_gap = <0x32>;
				cable_capability_level = <0x0 0x1388 0x1770 0x1b58>;
				vol_diff_level = <0x3e8 0x3e8 0x4b0 0x5dc>;
				pe50_vta_init = <0x14b4>;
				pe50_ita_init = <0xbb8>;
				run_cp_cur = <0x0 0x9c4 0x109a 0x2328>;
				run_cp_recovery_gap = <0x0 0x1f4 0x2ee 0x3e8>;
				run_wls_cp_cur = <0x0 0xbb8 0x1770 0x2710>;
				run_wls_cp_recovery_gap = <0x0 0xc8 0x190 0x258>;
				support_spec = <0x0 0x0 0x0 0x1 0x0>;
				vta_cap_min = <0x1a90 0x1a90 0x1a90 0x1770 0xfa0>;
				vta_cap_max = <0x7724 0x5014 0x5014 0x2904 0x1b58>;
				ita_cap_min = <0x3e8 0x3e8 0x3e8 0x3e8 0x3e8>;
				vbus_max_ovp = <0x80e8 0x5014 0x5014 0x2af8 0x1b58>;
				pe5_ffc_gap = <0x14 0x14 0x14 0x14 0x14 0x14>;
				step_ffc_level = <0x7>;
				step_ffc_level_0 = <0xa 0xf 0x1068 0x10cc 0x10cc 0x1130 0x1194 0x1194 0xfff 0xfff 0xfff 0xfff 0xfff 0xfff 0xfa 0xffffffff 0xffffffff 0x0 0xffffffff>;
				step_ffc_level_1 = <0xf 0x23 0x1068 0x10cc 0x1130 0x1194 0x1194 0x11b2 0x36b0 0x2328 0x2328 0x2328 0x2328 0x1770 0x3e8 0x0 0x12c 0x0 0xffffffff>;
				step_ffc_level_2 = <0xf 0x23 0x1068 0x10cc 0x1130 0x1194 0x1194 0x119e 0x36b0 0x2328 0x2328 0x2328 0x2328 0x1770 0x3e8 0x12c 0x258 0x14 0xffffffff>;
				step_ffc_level_3 = <0xf 0x23 0x1068 0x10cc 0x1130 0x118a 0x118a 0x118a 0x36b0 0x2328 0x2328 0x2328 0x2328 0x2328 0x3e8 0x258 0xffffffff 0x28 0xffffffff>;
				step_ffc_level_4 = <0x23 0x2d 0x1068 0x10cc 0x1130 0x1194 0x1194 0x11b2 0x36b0 0x2328 0x2328 0x2328 0x2328 0x1770 0x492 0x0 0x12c 0x0 0xffffffff>;
				step_ffc_level_5 = <0x23 0x2d 0x1068 0x10cc 0x1130 0x1194 0x1194 0x119e 0x36b0 0x2328 0x2328 0x2328 0x2328 0x1770 0x492 0x12c 0x258 0x14 0xffffffff>;
				step_ffc_level_6 = <0x23 0x2d 0x1068 0x10cc 0x1130 0x118a 0x118a 0x118a 0x36b0 0x2328 0x2328 0x2328 0x2328 0x2328 0x492 0x258 0xffffffff 0x28 0xffffffff>;
				phandle = <0x65>;
			};
			tc_tcpc {
				compatible = "tc_tcpc";
				status = "okay";
				phandle = <0x66>;
			};
			tc_adapter_control {
				compatible = "transsion, adapter_control";
				polling_interval = <0x1e>;
				status = "okay";
				phandle = <0x67>;
			};
		};
	};
	fragment@27 {
		target = <0xffffffff>;
		__overlay__ {
			compatible = "tc,charger";
			charger = <0x27>;
			enable_sw_jeita;
			enable_hv_charging;
			enable_sw_safety_timer;
			support_long_life_recharger;
			long_life_rechg_time = <0x1e>;
			bat_health_cycle_base = <0x0>;
			bat_health_dec_times = <0x50>;
			support_real_soc_decimal;
			enable_dynamic_mivr;
			enable_ir_comp;
			support_hardware_ir_comp;
			r_comp = <0xf>;
			v_comp_max = <0x28>;
			log_level = <0x3>;
			eoc_scheme = <0x1>;
			aging_start_uisoc = <0x46>;
			aging_stop_uisoc = <0x4b>;
			kom_start_uisoc = <0x28>;
			kom_stop_uisoc = <0x46>;
			batt_over_heat_temp = <0x3c>;
			batt_over_cold_temp = <0xffffffec>;
			polling_interval = <0xa>;
			support_si_bat;
			si_bat_cycle_def = <0x64 0xc8 0x1869f>;
			si_bat_cycle_vol = <0xbb8 0xc1c 0xc80>;
			min_charger_voltage = <0x432380>;
			min_charger_current = <0xf4240>;
			support_alg = "pe5", "pd", "hvdcp20", "tc30", "pe20";
			tbat_temp = <0xffffff9c 0xf 0x23 0x26 0x28 0x2a 0x2b 0x2c 0x37 0x3c 0x41 0x46>;
			tbat_ichg = <0x0 0x0 0x7a120 0xc3500 0xf4240 0x16e360 0x19f0a0 0x1e8480 0x249f00 0x249f00 0x249f00 0x249f00>;
			tbat_temp_gap = <0x1>;
			tpcb_temp = <0xffffff9c 0xf 0x1e 0x23 0x25 0x27 0x29 0x2d 0x37 0x3c 0x41 0x46>;
			tpcb_ichg = <0x0 0x0 0x0 0x30d40 0x493e0 0x7a120 0xaae60 0xdbba0 0x13d620 0x16e360 0x1e8480 0x1e8480>;
			tpcb_temp_gap = <0x1>;
			tpa_temp = <0xffffff9c 0xf 0x1e 0x23 0x25 0x27 0x29 0x2d 0x37 0x3c 0x41 0x46>;
			tpa_ichg = <0x0 0x0 0x0 0x30d40 0x493e0 0x7a120 0xaae60 0xdbba0 0x13d620 0x16e360 0x1e8480 0x1e8480>;
			tpa_temp_gap = <0x1>;
			batt_ht_temp = <0x35 0x37 0x3a>;
			batt_ht_rec_temp = <0x0 0x36 0x36>;
			batt_ht_code = <0x0 0x800 0x400>;
			batt_ht_vote_hiz = <0x0 0x0 0x0>;
			batt_ht_vote_discharge = <0x0 0x1 0x1>;
			batt_ht_vote_icon = <0x0 0x1 0x1>;
			batt_lt_temp = <0x0 0xffffffed 0xffffffed>;
			batt_lt_rec_temp = <0x0 0xffffffef 0xffffffef>;
			batt_lt_code = <0x0 0x0 0x1080>;
			batt_lt_vote_hiz = <0x0 0x0 0x0>;
			batt_lt_vote_discharge = <0x0 0x1 0x1>;
			batt_lt_vote_icon = <0x0 0x1 0x1>;
			kpoc_batt_ht_temp = <0x35 0x37 0x3a>;
			kpoc_batt_ht_rec_temp = <0x0 0x36 0x36>;
			kpoc_batt_ht_code = <0x0 0x800 0x400>;
			kpoc_batt_ht_vote_hiz = <0x0 0x0 0x0>;
			kpoc_batt_ht_vote_discharge = <0x0 0x1 0x1>;
			kpoc_batt_ht_vote_icon = <0x0 0x1 0x1>;
			kpoc_batt_lt_temp = <0x0 0xffffffed 0xffffffed>;
			kpoc_batt_lt_rec_temp = <0x0 0xffffffef 0xffffffef>;
			kpoc_batt_lt_code = <0x0 0x0 0x1080>;
			kpoc_batt_lt_vote_hiz = <0x0 0x0 0x0>;
			kpoc_batt_lt_vote_discharge = <0x0 0x1 0x1>;
			kpoc_batt_lt_vote_icon = <0x0 0x1 0x1>;
			batt_ht_temp_dis_chg = <0x3a 0x3a 0x3a>;
			batt_ht_code_dis_chg = <0x400 0x400 0x400>;
			batt_lt_temp_dis_chg = <0xffffffed 0xffffffed 0xffffffed>;
			batt_lt_code_dis_chg = <0x80 0x80 0x80>;
			dynamic_mivr_vol = <0x432380 0x432380 0x4630c0 0x47b760>;
			charger_voltage_ovp = <0x632ea0 0xa037a0 0xa7d8c0 0xa7d8c0>;
			max_charging_time = <0x11940>;
			sdp_charger_current = <0x7a120>;
			sdp_input_current = <0x7a120>;
			cdp_charger_current = <0xf4240>;
			cdp_input_current = <0xf4240>;
			dcp_charger_current = <0x1e8480>;
			dcp_input_current = <0x1e8480>;
			nonstd_charger_current = <0x124f80>;
			nonstd_input_current = <0x124f80>;
			max_input_current_limit = <0x2dc6c0>;
			max_charging_current_limit = <0x3010b0>;
			swchg_hw_eoc_max = <0xe7ef0>;
			smooth_soc_full_vol = <0x44aa20>;
			vbat_gap = <0x9c40 0x9c40 0x9c40 0x9c40 0x9c40 0x9c40>;
			single_batt_level = <0x7>;
			single_batt_level_0 = <0xffffffec 0xfffffff6 0xffffffff 0x432380 0x432380 0x432380 0x432380 0x432380 0x432380 0x72bf0 0x72bf0 0x72bf0 0x72bf0 0x72bf0 0x72bf0 0x3d090 0x0 0xffffffff 0x0>;
			single_batt_level_1 = <0xfffffff6 0x0 0xffffffff 0x432380 0x432380 0x432380 0x432380 0x432380 0x432380 0x927c0 0x927c0 0x927c0 0x927c0 0x927c0 0x927c0 0x3d090 0x0 0xffffffff 0x0>;
			single_batt_level_2 = <0x0 0xa 0xffffffff 0x44aa20 0x44aa20 0x44aa20 0x44aa20 0x44aa20 0x44aa20 0xf4240 0xf4240 0xf4240 0xf4240 0xf4240 0xf4240 0x3d090 0x0 0xffffffff 0x0>;
			single_batt_level_3 = <0xa 0xf 0xffffffff 0x44aa20 0x44aa20 0x44aa20 0x44aa20 0x44aa20 0x44aa20 0x3010b0 0x3010b0 0x3010b0 0x3010b0 0x3010b0 0x3010b0 0x3d090 0x0 0xffffffff 0x0>;
			single_batt_level_4 = <0xf 0x23 0xffffffff 0x44aa20 0x44aa20 0x44aa20 0x44aa20 0x44aa20 0x44aa20 0x3010b0 0x3010b0 0x3010b0 0x3010b0 0x3010b0 0x3010b0 0x3d090 0x0 0xffffffff 0x0>;
			single_batt_level_5 = <0x23 0x2d 0xffffffff 0x44aa20 0x44aa20 0x44aa20 0x44aa20 0x44aa20 0x44aa20 0x3010b0 0x3010b0 0x3010b0 0x3010b0 0x3010b0 0x3010b0 0x3d090 0x0 0xffffffff 0x0>;
			single_batt_level_6 = <0x2d 0x3c 0xffffffff 0x401640 0x401640 0x401640 0x401640 0x401640 0x401640 0x2625a0 0x2625a0 0x2625a0 0x2625a0 0x2625a0 0x2625a0 0x3d090 0x0 0xffffffff 0x0>;
		};
	};
	fragment@28 {
		target = <0xffffffff>;
		__overlay__ {
			charger = <0x27>;
		};
	};
	fragment@29 {
		target = <0xffffffff>;
		__overlay__ {
			charger = <0x27>;
		};
	};
	fragment@30 {
		target = <0xffffffff>;
		__overlay__ {
			charger = <0x27>;
		};
	};
	fragment@31 {
		target = <0xffffffff>;
		__overlay__ {
			charger = <0x27>;
		};
	};
	fragment@32 {
		target = <0xffffffff>;
		__overlay__ {
			compatible = "mediatek,lk_charger";
			enable_anime;
			enable_pe_plus;
			enable_pd20_reset;
			power_path_support;
			max_charger_voltage = <0x632ea0>;
			fast_charge_voltage = <0x231860>;
			boot_chg_battery_voltage = <0x30d400>;
			low_power_charger_vbat = <0x30d400>;
			low_bat_temp_boot_vbat = <0x36ee80>;
			boot_battery_voltage = <0x30d400>;
			usb_charger_current = <0x7a120>;
			ac_charger_current = <0x1e8480>;
			ac_charger_input_current = <0x1e8480>;
			non_std_ac_charger_current = <0x7a120>;
			charging_host_charger_current = <0x16e360>;
			ta_ac_charger_current = <0x2dc6c0>;
			pd_charger_current = <0x7a120>;
			cur_threshold = <0x7a120>;
			temp_t0_current = <0x16e360>;
			temp_neg_t0_current = <0x1ab3f0>;
			temp_t4_threshold = <0x38>;
			temp_t3_threshold = <0x2d>;
			temp_t2_threshold = <0xf>;
			temp_t1_threshold = <0x0>;
			temp_t0_threshold = <0xfffffff6>;
			temp_neg_t0_threshold = <0xffffffec>;
		};
	};
	fragment@33 {
		target = <0xffffffff>;
		__overlay__ {
			pca_tfcp_ta {
				compatible = "tc,pca_tfcp_ta";
				status = "okay";
				adapter_name = "tfcp_adapter";
				vta_step = <0x28>;
				ita_step = <0x1e>;
				ita_gap_per_vstep = <0x14>;
				ita_gap_cv_mode = <0x64>;
				pwr_lmt;
				support_meas_cap;
				support_status;
			};
			tc_pd_adapter {
				compatible = "tc,pd_adapter";
				boot_mode = <0xffffffff>;
				adapter_name = "pd_adapter";
				force_cv;
				phys = <0xffffffff 0x3>;
				phy-names = "usb2-phy";
				status = "okay";
				phandle = <0x68>;
			};
		};
	};
	fragment@34 {
		target = <0xffffffff>;
		__overlay__ {
			clock-frequency = <0x186a0>;
			tfcp_ta@1b {
				compatible = "tc,tfcp_ta";
				pinctrl-names = "tfcp_i2c_sclk_mode", "tfcp_i2c_sda_mode";
				pinctrl-0 = <0x28>;
				pinctrl-1 = <0x29>;
				reg = <0x1b>;
				status = "okay";
			};
		};
	};
	fragment@35 {
		target = <0xffffffff>;
		__overlay__ {
			tfcp_i2c_sclk_mode {
				phandle = <0x28>;
				pins_cmd_dat {
					pinmux = <0x6f01>;
					bias-pull-up = <0xc9>;
					mediatek,drive-strength-adv = <0x0>;
					drive-strength = <0x7>;
				};
			};
			tfcp_i2c_sda_mode {
				phandle = <0x29>;
				pins_cmd_dat {
					pinmux = <0x7001>;
					bias-pull-up = <0xc9>;
					mediatek,drive-strength-adv = <0x0>;
					drive-strength = <0x7>;
				};
			};
		};
	};
	fragment@36 {
		target = <0xffffffff>;
		__overlay__ {
			#address-cells = <0x1>;
			#size-cells = <0x0>;
			hl7138_master@55 {
				compatible = "tc,hl7139";
				status = "okay";
				reg = <0x55>;
				rm_name = "hl7139";
				rm_slave_addr = [55];
				hl7138,intr-gpios = <0xffffffff 0xb 0x0>;
				standalone {
					chg_name = "primary_dvchg";
					vbatovp = <0x456d70>;
					ibatocp = <0x6c5660>;
					vbusovp = <0xa7d8c0>;
					ibusocp = <0x40d990>;
					vacovp = <0xa7d8c0>;
					wdt = <0x1c9c380>;
					ibat_rsense = <0x1>;
					gpp_conf = <0x0>;
					protocol_i_masked;
					vbat_reg_dis;
					ibat_reg_dis;
					iin_reg_dis;
					ibatocp_dis;
					ibusocp_dis;
				};
				master {
					chg_name = "primary_dvchg";
					vbatovp = <0x44aa20>;
					ibatocp = <0x5d1420>;
					vbusovp = <0x989680>;
					ibusocp = <0x40d990>;
					vacovp = <0xa7d8c0>;
					wdt = <0x1c9c380>;
					ibat_rsense = <0x1>;
					state_chg_i_masked = <0x0>;
					reg_i_masked = <0x0>;
					ts_temp_i_masked = <0x0>;
					v_ok_i_masked = <0x0>;
					cur_i_masked = <0x0>;
					short_i_masked = <0x0>;
					wdog_i_masked = <0x0>;
					protocol_i_masked = <0x0>;
					vbat_reg_dis;
					ibat_reg_dis;
					iin_reg_dis;
					track_ov_dis;
					track_uv_dis;
					ibatocp_dis;
					tsbusotp_dis;
					tsbatotp_dis;
					tsbusadc_dis;
					tsbatadc_dis;
				};
			};
		};
	};
	fragment@37 {
		target = <0xffffffff>;
		__overlay__ {
			#address-cells = <0x1>;
			#size-cells = <0x0>;
			hl7138_slave@55 {
				compatible = "tc,hl7139";
				status = "okay";
				reg = <0x55>;
				rm_name = "hl7139";
				rm_slave_addr = [55];
				hl7138,intr-gpios = <0xffffffff 0x7 0x0>;
				standalone {
					chg_name = "secondary_dvchg";
					vbatovp = <0x456d70>;
					ibatocp = <0x6c5660>;
					vbusovp = <0xa7d8c0>;
					ibusocp = <0x40d990>;
					vacovp = <0xa7d8c0>;
					wdt = <0x1c9c380>;
					ibat_rsense = <0x1>;
					gpp_conf = <0x0>;
					protocol_i_masked = <0x1>;
					vbat_reg_dis;
					ibat_reg_dis;
					iin_reg_dis;
					ibatocp_dis;
					wdt_dis;
				};
				slave {
					chg_name = "secondary_dvchg";
					vbatovp = <0x44aa20>;
					ibatocp = <0x5d1420>;
					vbusovp = <0x989680>;
					ibusocp = <0x40d990>;
					vacovp = <0xa7d8c0>;
					wdt = <0x1c9c380>;
					ibat_rsense = <0x1>;
					state_chg_i_masked = <0x0>;
					reg_i_masked = <0x0>;
					ts_temp_i_masked = <0x0>;
					v_ok_i_masked = <0x0>;
					cur_i_masked = <0x0>;
					short_i_masked = <0x0>;
					wdog_i_masked = <0x0>;
					protocol_i_masked = <0x0>;
					vbat_reg_dis;
					ibat_reg_dis;
					iin_reg_dis;
					track_ov_dis;
					track_uv_dis;
					ibatocp_dis;
					wdt_dis;
					tsbusotp_dis;
					tsbatotp_dis;
					tsbusadc_dis;
					tsbatadc_dis;
				};
			};
		};
	};
	fragment@38 {
		target = <0xffffffff>;
		__overlay__ {
			tc_led {
				compatible = "tc,led";
				status = "okay";
				phandle = <0x69>;
			};
		};
	};
	fragment@39 {
		target = <0xffffffff>;
		__overlay__ {
			status = "okay";
			clock-frequency = <0xf4240>;
			#address-cells = <0x1>;
			#size-cells = <0x0>;
			aw20216_led@20 {
				compatible = "awinic,aw20216_led";
				reg = <0x20>;
				enable-gpio = <0xffffffff 0x2e 0x0>;
				aw20216,imax = <0x16>;
				aw20216,sl_current = <0x16>;
				aw20216,max_brightness = <0x16>;
				aw20216,effect-bin;
				ignore_open_circuit_test_cfg_size = <0x6>;
				ignore_open_circuit_test_cfg_reg = <0x19 0x1c 0x1f 0x22 0x24 0x25>;
				ignore_open_circuit_test_cfg_val = <0x20 0x20 0x20 0x20 0x20 0x20>;
				status = "okay";
			};
		};
	};
	fragment@40 {
		target = <0xffffffff>;
		__overlay__ {
			lra,info = <0x2 0x8 0x59>;
		};
	};
	fragment@41 {
		target = <0xffffffff>;
		__overlay__ {
			fshaptic@34 {
				compatible = "foursemi,fshaptic";
				reg = <0x34>;
				fs3001_i2c_addr = <0x34>;
				reset-gpio = <0xffffffff 0x59 0x0>;
				irq-gpio = <0xffffffff 0x30 0x0>;
				fs3001_f0_ref = <0x92e>;
				fs3001_auto_brake = <0x0>;
				fs3001_f0_cali_mode = <0x0>;
				fs3001_cont_drv1_lvl = <0x7f>;
				fs3001_cont_drv2_lvl = <0x36>;
				fs3001_cont_drv1_time = <0x4>;
				fs3001_cont_drv2_time = <0x14>;
				fs3001_cont_1_period = <0x264>;
				fs3001_brk_slopeth = <0x14>;
				fs3001_brk_gain = <0x80>;
				fs3001_brk_times = <0x14>;
				fs3001_brk_noise_gate = <0x30>;
				fs3001_brk_1_period = <0x198>;
				fs3001_brk_pgagain = <0x5>;
				fs3001_brk_margin = <0x30>;
				fs3001_play_ram_srate = <0x0>;
				fs3001_play_rtp_srate = <0x1>;
				fs3001_default_vib_mode = <0x3>;
				fs3001_vbat_mode = <0x0>;
				fs3001_lk_f0_cali = <0x0>;
				fs3001_bypass_system_gain = <0x1>;
				fs3001_f0_cali_data_mode = <0x1>;
				fs3001_lr_pgagain = <0x5>;
				fs3001_reg_inits = <0xffffff 0xffffff 0xffffff 0xffffff 0xffffff 0xffffff 0xffffff 0xffffff 0xffffff 0xffffff>;
				fs3001_duration_time = <0x1e 0x3c 0x5a>;
				fs3001_rtp_id_boundary = <0x0>;
				fs3001_rtp_max = <0x3>;
				fs3001_rtp_time = <0x14 0x14 0x14>;
				status = "okay";
			};
		};
	};
	fragment@42 {
		target = <0xffffffff>;
		__overlay__ {
			touch {
				compatible = "mediatek,touch";
				supplier-num = <0x1>;
				supplier-vendor-0 = "TM";
				supplier-0 = "any, focaltech, ft3683g";
				supplier-resolution-0 = <0x10>;
				interrupt-parent = <0xffffffff>;
				interrupts = <0xe 0x8>;
				status = "okay";
				phandle = <0x6a>;
			};
		};
	};
	fragment@43 {
		target = <0xffffffff>;
		__overlay__ {
			focaltech@0 {
				compatible = "focaltech,fts";
				reg = <0x0>;
				spi-max-frequency = <0x7a1200>;
				vtouch-supply = <0xffffffff>;
				focaltech,irq-gpio = <0xffffffff 0xe 0x0>;
				focaltech,reset-gpio = <0xffffffff 0x13 0x0>;
				focaltech,iovdd-gpio = <0xffffffff 0x45 0x0>;
				focaltech,max-touch-number = <0xa>;
				focaltech,display-coords = <0x0 0x0 0x437f 0x983f>;
				focaltech,fod-function-support;
				focaltech,pocket-function-support;
				status = "okay";
				pinctrl-names = "default", "state_spi_mode";
				pinctrl-0 = <0x2a>;
				pinctrl-1 = <0x2b>;
			};
		};
	};
	fragment@44 {
		target = <0xffffffff>;
		__overlay__ {
			ctp_default {
				phandle = <0x2a>;
			};
			ctp_spimode_default {
				phandle = <0x2b>;
				pins_cmd_dat {
					pinmux = <0x6102 0x6202 0xd02 0xc02>;
					drive-strength = <0x2>;
				};
			};
		};
	};
	fragment@45 {
		target = <0xffffffff>;
		__overlay__ {
			camera_pins_cam0_mclk_off {
				phandle = <0x2d>;
				pins_cmd_dat {
					pinmux = <0x3200>;
					drive-strength = <0x1>;
				};
			};
			camera_pins_cam0_mclk_2ma {
				phandle = <0x2e>;
				pins_cmd_dat {
					pinmux = <0x3201>;
					drive-strength = <0x0>;
				};
			};
			camera_pins_cam0_mclk_4ma {
				phandle = <0x2f>;
				pins_cmd_dat {
					pinmux = <0x3201>;
					drive-strength = <0x1>;
				};
			};
			camera_pins_cam0_mclk_6ma {
				phandle = <0x30>;
				pins_cmd_dat {
					pinmux = <0x3201>;
					drive-strength = <0x2>;
				};
			};
			camera_pins_cam0_mclk_8ma {
				phandle = <0x31>;
				pins_cmd_dat {
					pinmux = <0x3201>;
					drive-strength = <0x3>;
				};
			};
			camera_pins_cam1_mclk_off {
				phandle = <0x32>;
				pins_cmd_dat {
					pinmux = <0x3100>;
					drive-strength = <0x1>;
				};
			};
			camera_pins_cam1_mclk_2ma {
				phandle = <0x33>;
				pins_cmd_dat {
					pinmux = <0x3101>;
					drive-strength = <0x0>;
				};
			};
			camera_pins_cam1_mclk_4ma {
				phandle = <0x34>;
				pins_cmd_dat {
					pinmux = <0x3101>;
					drive-strength = <0x1>;
				};
			};
			camera_pins_cam1_mclk_6ma {
				phandle = <0x35>;
				pins_cmd_dat {
					pinmux = <0x3101>;
					drive-strength = <0x2>;
				};
			};
			camera_pins_cam1_mclk_8ma {
				phandle = <0x36>;
				pins_cmd_dat {
					pinmux = <0x3101>;
					drive-strength = <0x3>;
				};
			};
			camera_pins_cam2_mclk_off {
				phandle = <0x37>;
				pins_cmd_dat {
					pinmux = <0x3300>;
					drive-strength = <0x1>;
				};
			};
			camera_pins_cam2_mclk_2ma {
				phandle = <0x38>;
				pins_cmd_dat {
					pinmux = <0x3301>;
					drive-strength = <0x0>;
				};
			};
			camera_pins_cam2_mclk_4ma {
				phandle = <0x39>;
				pins_cmd_dat {
					pinmux = <0x3301>;
					drive-strength = <0x1>;
				};
			};
			camera_pins_cam2_mclk_6ma {
				phandle = <0x3a>;
				pins_cmd_dat {
					pinmux = <0x3301>;
					drive-strength = <0x2>;
				};
			};
			camera_pins_cam2_mclk_8ma {
				phandle = <0x3b>;
				pins_cmd_dat {
					pinmux = <0x3301>;
					drive-strength = <0x3>;
				};
			};
			camdefault {
				phandle = <0x2c>;
			};
		};
	};
	fragment@46 {
		target = <0xffffffff>;
		__overlay__ {
			pinctrl-names = "default", "cam0_mclk_off", "cam0_mclk_2mA", "cam0_mclk_4mA", "cam0_mclk_6mA", "cam0_mclk_8mA", "cam1_mclk_off", "cam1_mclk_2mA", "cam1_mclk_4mA", "cam1_mclk_6mA", "cam1_mclk_8mA", "cam2_mclk_off", "cam2_mclk_2mA", "cam2_mclk_4mA", "cam2_mclk_6mA", "cam2_mclk_8mA";
			pinctrl-0 = <0x2c>;
			pinctrl-1 = <0x2d>;
			pinctrl-2 = <0x2e>;
			pinctrl-3 = <0x2f>;
			pinctrl-4 = <0x30>;
			pinctrl-5 = <0x31>;
			pinctrl-6 = <0x32>;
			pinctrl-7 = <0x33>;
			pinctrl-8 = <0x34>;
			pinctrl-9 = <0x35>;
			pinctrl-10 = <0x36>;
			pinctrl-11 = <0x37>;
			pinctrl-12 = <0x38>;
			pinctrl-13 = <0x39>;
			pinctrl-14 = <0x3a>;
			pinctrl-15 = <0x3b>;
			cam0_pin_mclk = "mclk";
			cam0_pin_pdn = "regulator";
			cam0_pin_rst = "regulator";
			cam0_pin_vcama = "regulator";
			cam0_pin_vcamd = "regulator";
			cam0_pin_vcamio = "regulator";
			cam1_pin_mclk = "mclk";
			cam1_pin_pdn = "regulator";
			cam1_pin_rst = "regulator";
			cam1_pin_vcama = "regulator";
			cam1_pin_vcamd = "regulator";
			cam1_pin_vcamio = "regulator";
			cam2_pin_mclk = "mclk";
			cam2_pin_pdn = "regulator";
			cam2_pin_rst = "regulator";
			cam2_pin_vcama = "regulator";
			cam2_pin_vcamd = "regulator";
			cam2_pin_vcamio = "regulator";
			cam3_pin_vcama = "regulator";
			cam0_vcama-supply = <0x3c>;
			cam0_vcamd-supply = <0x3d>;
			cam0_vcamio-supply = <0xffffffff>;
			cam0_vcamrst-supply = <0x3e>;
			cam1_vcama-supply = <0x3f>;
			cam1_vcamd-supply = <0x40>;
			cam1_vcamio-supply = <0xffffffff>;
			cam1_vcamrst-supply = <0x41>;
			cam1_vcampdn-supply = <0x42>;
			cam2_vcama-supply = <0x43>;
			cam2_vcamio-supply = <0xffffffff>;
			cam2_vcamrst-supply = <0x44>;
			cam3_vcama-supply = <0x43>;
			cam0_enable_sensor = "s5khm2sp_mipi_raw";
			cam1_enable_sensor = "gc32e1_mipi_raw";
			cam2_enable_sensor = "gc02m3_mipi_raw";
			cam3_enable_sensor = "fake_serial_yuv";
			camera_input_gpio = <0xffffffff 0x10 0x0>;
			status = "okay";
		};
	};
	fragment@47 {
		target = <0xffffffff>;
		__overlay__ {
			camera-eeprom0@50 {
				compatible = "mediatek,camera_eeprom";
				reg = <0x50>;
				status = "okay";
				phandle = <0x6b>;
			};
		};
	};
	fragment@48 {
		target = <0xffffffff>;
		__overlay__ {
			camera-eeprom1@51 {
				compatible = "mediatek,camera_eeprom";
				reg = <0x51>;
				status = "okay";
				phandle = <0x6c>;
			};
		};
	};
	fragment@49 {
		target = <0xffffffff>;
		__overlay__ {
			et5904@28 {
				compatible = "tran,et5904";
				reg = <0x28>;
				VIND-supply = <0x45>;
				regulators {
					ET5904LDO18 {
						regulator-name = "ET5904LDO18";
						regulator-min-microvolt = <0x927c0>;
						regulator-max-microvolt = <0x1b7740>;
						phandle = <0x40>;
					};
					ET5904LDO28 {
						regulator-name = "ET5904LDO28";
						regulator-min-microvolt = <0x927c0>;
						regulator-max-microvolt = <0x1b7740>;
						phandle = <0x3d>;
					};
					ET5904LDO38 {
						regulator-name = "ET5904LDO38";
						regulator-min-microvolt = <0x124f80>;
						regulator-max-microvolt = <0x325aa0>;
						phandle = <0x3f>;
					};
					ET5904LDO48 {
						regulator-name = "ET5904LDO48";
						regulator-min-microvolt = <0x124f80>;
						regulator-max-microvolt = <0x325aa0>;
						phandle = <0x3c>;
					};
				};
			};
		};
	};
	fragment@50 {
		target = <0xffffffff>;
		__overlay__ {
			flashlights_ocp81375 {
				compatible = "mediatek,flashlights_ocp81375";
				ocp81375_regulator-supply = <0x46>;
				back-supply = <0x47>;
				front_warm-supply = <0x48>;
				status = "okay";
				phandle = <0x6d>;
			};
			flashlights_aw36515 {
				compatible = "mediatek,flashlights_aw36515";
				aw36515_regulator-supply = <0x46>;
				back-supply = <0x47>;
				front_warm-supply = <0x48>;
				status = "okay";
				phandle = <0x6e>;
			};
			vs2pmu {
				compatible = "regulator-fixed";
				regulator-name = "vs2pmu";
				regulator-min-microvolt = <0x1b7740>;
				regulator-max-microvolt = <0x1b7740>;
				gpio = <0xffffffff 0x2c 0x0>;
				enable-active-high;
				phandle = <0x45>;
			};
			LDO4EN {
				compatible = "regulator-fixed";
				regulator-name = "et5904en4";
				regulator-min-microvolt = <0x1b7740>;
				regulator-max-microvolt = <0x1b7740>;
				gpio = <0xffffffff 0x5b 0x0>;
				enable-active-low;
				regulator-always-on;
				regulator-boot-on;
				phandle = <0x6f>;
			};
			cam0rst_gpio56 {
				compatible = "regulator-fixed";
				regulator-name = "cam0rst_gpio56";
				regulator-min-microvolt = <0x1b7740>;
				regulator-max-microvolt = <0x1b7740>;
				gpio = <0xffffffff 0x38 0x0>;
				enable-active-high;
				phandle = <0x3e>;
			};
			cam1pdn_gpio53 {
				compatible = "regulator-fixed";
				regulator-name = "cam1pdn_gpio53";
				regulator-min-microvolt = <0x1b7740>;
				regulator-max-microvolt = <0x1b7740>;
				gpio = <0xffffffff 0x35 0x0>;
				enable-active-high;
				phandle = <0x42>;
			};
			cam0rst_gpio54 {
				compatible = "regulator-fixed";
				regulator-name = "cam0rst_gpio54";
				regulator-min-microvolt = <0x1b7740>;
				regulator-max-microvolt = <0x1b7740>;
				gpio = <0xffffffff 0x36 0x0>;
				enable-active-high;
				phandle = <0x41>;
			};
			cam23avdd_gpio20 {
				compatible = "regulator-fixed";
				regulator-name = "cam23avdd_gpio20";
				regulator-min-microvolt = <0x2ab980>;
				regulator-max-microvolt = <0x2ab980>;
				gpio = <0xffffffff 0x14 0x0>;
				enable-active-high;
				phandle = <0x43>;
			};
			cam2rst_gpio58 {
				compatible = "regulator-fixed";
				regulator-name = "cam2rst_gpio58";
				regulator-min-microvolt = <0x1b7740>;
				regulator-max-microvolt = <0x1b7740>;
				gpio = <0xffffffff 0x3a 0x0>;
				enable-active-high;
				phandle = <0x44>;
			};
			flashlight_gpio134 {
				compatible = "regulator-fixed";
				regulator-name = "flashlight_gpio134";
				regulator-min-microvolt = <0x1b7740>;
				regulator-max-microvolt = <0x1b7740>;
				gpio = <0xffffffff 0x86 0x0>;
				enable-active-high;
				phandle = <0x46>;
			};
			flashlight_gpio40 {
				compatible = "regulator-fixed";
				regulator-name = "flashlight_gpio40";
				regulator-min-microvolt = <0x1b7740>;
				regulator-max-microvolt = <0x1b7740>;
				gpio = <0xffffffff 0x28 0x0>;
				enable-active-high;
				phandle = <0x48>;
			};
			flashlight_gpio42 {
				compatible = "regulator-fixed";
				regulator-name = "flashlight_gpio42";
				regulator-min-microvolt = <0x1b7740>;
				regulator-max-microvolt = <0x1b7740>;
				gpio = <0xffffffff 0x2a 0x0>;
				enable-active-high;
				phandle = <0x47>;
			};
		};
	};
	fragment@51 {
		target = <0xffffffff>;
		__overlay__ {
			camaf_m1_pmic-supply = <0xffffffff>;
		};
	};
	fragment@52 {
		target = <0xffffffff>;
		__overlay__ {
			adc_channel@ {
				compatible = "mediatek,adc_channel";
				mediatek,temperature0 = <0x0>;
				mediatek,temperature1 = <0x1>;
				mediatek,adc_fdd_rf_params_dynamic_custom_ch = <0x5>;
				status = "okay";
			};
		};
	};
	fragment@53 {
		target = <0xffffffff>;
		__overlay__ {
			io-channels = <0xffffffff 0x5>;
		};
	};
	fragment@54 {
		target = <0xffffffff>;
		__overlay__ {
			mediatek,clkbuf-quantity = <0x7>;
			mediatek,clkbuf-config = <0x2 0x1 0x1 0x2 0x0 0x0 0x1>;
			mediatek,clkbuf-output-impedance = <0x6 0x4 0x4 0x4 0x0 0x0 0x3>;
			mediatek,clkbuf-controls-for-desense = <0x0 0x4 0x0 0x4 0x0 0x0 0x0>;
			status = "okay";
		};
	};
	fragment@55 {
		target = <0xffffffff>;
		__overlay__ {
			#address-cells = <0x1>;
			#size-cells = <0x0>;
			clock-frequency = <0x61a80>;
			mediatek,use-open-drain;
		};
	};
	fragment@56 {
		target = <0xffffffff>;
		__overlay__ {
			#address-cells = <0x1>;
			#size-cells = <0x0>;
			clock-frequency = <0x61a80>;
			mediatek,use-open-drain;
		};
	};
	fragment@57 {
		target = <0xffffffff>;
		__overlay__ {
			#address-cells = <0x1>;
			#size-cells = <0x0>;
			clock-frequency = <0x61a80>;
			mediatek,use-open-drain;
			camera_main_two@10 {
				compatible = "mediatek,camera_main_two";
				reg = <0x10>;
				status = "okay";
				phandle = <0x70>;
			};
		};
	};
	fragment@58 {
		target = <0xffffffff>;
		__overlay__ {
			#address-cells = <0x1>;
			#size-cells = <0x0>;
			clock-frequency = <0x61a80>;
			mediatek,use-open-drain;
			nfc@28 {
				compatible = "mediatek,nfc";
				reg = <0x28>;
				status = "okay";
				phandle = <0x71>;
			};
		};
	};
	fragment@59 {
		target = <0xffffffff>;
		__overlay__ {
			#address-cells = <0x1>;
			#size-cells = <0x0>;
			clock-frequency = <0xf4240>;
			mediatek,use-open-drain;
			camera_main@1a {
				compatible = "mediatek,camera_main";
				reg = <0x1a>;
				status = "okay";
				phandle = <0x72>;
			};
			camera_main_af@72 {
				compatible = "mediatek,camera_main_af";
				reg = <0x72>;
				status = "okay";
				phandle = <0x73>;
			};
		};
	};
	fragment@60 {
		target = <0xffffffff>;
		__overlay__ {
			#address-cells = <0x1>;
			#size-cells = <0x0>;
			clock-frequency = <0x33e140>;
			mediatek,use-push-pull;
		};
	};
	fragment@61 {
		target = <0xffffffff>;
		__overlay__ {
			#address-cells = <0x1>;
			#size-cells = <0x0>;
			clock-frequency = <0x61a80>;
			mediatek,use-open-drain;
			i2c_lcd_bias@73 {
				compatible = "mediatek,i2c_lcd_bias";
				reg = <0x73>;
				status = "okay";
				phandle = <0x74>;
			};
		};
	};
	fragment@62 {
		target = <0xffffffff>;
		__overlay__ {
			#address-cells = <0x1>;
			#size-cells = <0x0>;
			clock-frequency = <0x186a0>;
			mediatek,use-open-drain;
		};
	};
	fragment@63 {
		target = <0xffffffff>;
		__overlay__ {
			#address-cells = <0x1>;
			#size-cells = <0x0>;
			clock-frequency = <0x61a80>;
			mediatek,use-open-drain;
			strobe_main@63 {
				compatible = "mediatek,strobe_main";
				reg = <0x63>;
				status = "okay";
				phandle = <0x75>;
			};
		};
	};
	fragment@64 {
		target = <0xffffffff>;
		__overlay__ {
			#address-cells = <0x1>;
			#size-cells = <0x0>;
			clock-frequency = <0x61a80>;
			mediatek,use-open-drain;
			camera_sub@1a {
				compatible = "mediatek,camera_sub";
				reg = <0x1a>;
				status = "okay";
				phandle = <0x76>;
			};
		};
	};
	fragment@65 {
		target = <0xffffffff>;
		__overlay__ {
			GPIO_FDD_BAND_SUPPORT_DETECT_2ND_PIN = <0xffffffff 0x2d 0x0>;
			GPIO_FDD_BAND_SUPPORT_DETECT_3RD_PIN = <0xffffffff 0x2e 0x0>;
			GPIO_SIM1_HOT_PLUG = <0xffffffff 0x4d 0x0>;
			GPIO_SIM2_SCLK = <0xffffffff 0x77 0x0>;
			GPIO_SIM2_SRST = <0xffffffff 0x78 0x0>;
			GPIO_SIM2_SIO = <0xffffffff 0x79 0x0>;
			GPIO_SIM1_SIO = <0xffffffff 0x7a 0x0>;
			GPIO_SIM1_SRST = <0xffffffff 0x7b 0x0>;
			GPIO_SIM1_SCLK = <0xffffffff 0x7c 0x0>;
			GPIO_RF_PWREN_RST_PIN = <0xffffffff 0xaa 0x0>;
		};
	};
	fragment@66 {
		target = <0xffffffff>;
		__overlay__ {
			gpio_init_default = <0x0 0x0 0x0 0x0 0x1 0x0 0x1 0x1 0x0 0x0 0x0 0x1 0x1 0x1 0x2 0x0 0x0 0x0 0x1 0x1 0x1 0x3 0x0 0x0 0x0 0x1 0x0 0x1 0x4 0x0 0x0 0x0 0x1 0x1 0x1 0x5 0x0 0x0 0x0 0x1 0x0 0x1 0x6 0x0 0x1 0x0 0x1 0x0 0x1 0x7 0x0 0x1 0x0 0x1 0x0 0x1 0x8 0x7 0x0 0x0 0x1 0x0 0x1 0x9 0x0 0x0 0x0 0x1 0x1 0x1 0xa 0x0 0x0 0x0 0x1 0x1 0x1 0xb 0x0 0x0 0x0 0x1 0x1 0x1 0xc 0x2 0x0 0x0 0x1 0x0 0x1 0xd 0x2 0x0 0x0 0x1 0x0 0x1 0xe 0x0 0x0 0x0 0x1 0x1 0x1 0xf 0x0 0x0 0x0 0x1 0x1 0x1 0x10 0x0 0x0 0x0 0x0 0x0 0x0 0x11 0x0 0x1 0x0 0x1 0x0 0x0 0x12 0x7 0x0 0x0 0x1 0x0 0x0 0x13 0x0 0x0 0x0 0x0 0x0 0x1 0x14 0x0 0x1 0x0 0x1 0x0 0x1 0x15 0x7 0x0 0x0 0x1 0x0 0x1 0x16 0x7 0x0 0x0 0x1 0x0 0x1 0x17 0x1 0x0 0x0 0x1 0x0 0x1 0x18 0x0 0x0 0x0 0x1 0x0 0x1 0x19 0x1 0x0 0x0 0x1 0x0 0x1 0x1a 0x1 0x0 0x0 0x1 0x0 0x1 0x1b 0x0 0x0 0x0 0x1 0x0 0x1 0x1c 0x0 0x1 0x0 0x1 0x0 0x1 0x1d 0x1 0x0 0x0 0x0 0x0 0x1 0x1e 0x1 0x0 0x0 0x1 0x0 0x1 0x1f 0x2 0x0 0x0 0x0 0x0 0x1 0x20 0x2 0x0 0x0 0x0 0x0 0x1 0x21 0x2 0x0 0x0 0x0 0x0 0x1 0x22 0x2 0x0 0x0 0x1 0x0 0x1 0x23 0x1 0x0 0x0 0x1 0x0 0x1 0x24 0x1 0x0 0x0 0x1 0x0 0x1 0x25 0x1 0x0 0x0 0x1 0x0 0x1 0x26 0x1 0x0 0x0 0x1 0x0 0x1 0x27 0x0 0x0 0x0 0x1 0x1 0x1 0x28 0x0 0x1 0x0 0x1 0x0 0x1 0x29 0x1 0x0 0x0 0x0 0x0 0x1 0x2a 0x0 0x1 0x0 0x1 0x0 0x1 0x2b 0x1 0x0 0x0 0x0 0x0 0x1 0x2c 0x0 0x1 0x0 0x1 0x0 0x1 0x2d 0x0 0x0 0x0 0x1 0x0 0x1 0x2e 0x0 0x0 0x0 0x1 0x0 0x1 0x2f 0x0 0x1 0x0 0x1 0x0 0x1 0x30 0x0 0x0 0x0 0x1 0x0 0x1 0x31 0x1 0x0 0x0 0x0 0x0 0x1 0x32 0x1 0x0 0x0 0x0 0x0 0x1 0x33 0x1 0x0 0x0 0x0 0x0 0x1 0x34 0x1 0x0 0x0 0x0 0x0 0x1 0x35 0x0 0x1 0x0 0x1 0x0 0x1 0x36 0x0 0x1 0x0 0x1 0x0 0x1 0x37 0x0 0x1 0x0 0x1 0x0 0x1 0x38 0x0 0x1 0x0 0x1 0x0 0x1 0x39 0x7 0x1 0x0 0x0 0x0 0x1 0x3a 0x0 0x1 0x0 0x1 0x0 0x1 0x3b 0x1 0x0 0x0 0x1 0x0 0x1 0x3c 0x0 0x1 0x0 0x1 0x0 0x1 0x3d 0x1 0x0 0x0 0x1 0x1 0x1 0x3e 0x1 0x0 0x0 0x0 0x0 0x1 0x3f 0x1 0x0 0x0 0x1 0x1 0x1 0x40 0x1 0x0 0x0 0x0 0x0 0x1 0x45 0x0 0x1 0x0 0x1 0x0 0x0 0x46 0x0 0x1 0x0 0x1 0x0 0x0 0x4d 0x1 0x0 0x0 0x1 0x1 0x1 0x4e 0x0 0x0 0x0 0x1 0x0 0x1 0x4f 0x1 0x0 0x0 0x1 0x1 0x1 0x50 0x1 0x0 0x0 0x1 0x1 0x1 0x51 0x1 0x0 0x0 0x1 0x0 0x1 0x52 0x0 0x1 0x0 0x1 0x0 0x1 0x53 0x1 0x0 0x0 0x0 0x0 0x1 0x54 0x1 0x0 0x0 0x1 0x0 0x1 0x55 0x1 0x0 0x0 0x0 0x0 0x1 0x56 0x0 0x1 0x0 0x1 0x0 0x1 0x57 0x2 0x0 0x0 0x1 0x0 0x1 0x58 0x0 0x0 0x0 0x1 0x0 0x1 0x59 0x0 0x0 0x0 0x1 0x0 0x1 0x5a 0x1 0x0 0x0 0x0 0x0 0x1 0x5b 0x0 0x1 0x0 0x1 0x0 0x1 0x5c 0x0 0x1 0x0 0x1 0x1 0x1 0x5d 0x0 0x1 0x0 0x1 0x0 0x1 0x5e 0x0 0x1 0x0 0x1 0x0 0x1 0x5f 0x1 0x0 0x0 0x1 0x0 0x1 0x60 0x1 0x0 0x0 0x1 0x0 0x1 0x61 0x2 0x0 0x0 0x1 0x1 0x1 0x62 0x2 0x0 0x0 0x1 0x1 0x1 0x63 0x2 0x0 0x0 0x1 0x1 0x1 0x64 0x2 0x0 0x0 0x1 0x1 0x1 0x65 0x1 0x0 0x0 0x1 0x1 0x1 0x66 0x1 0x0 0x0 0x1 0x1 0x1 0x67 0x1 0x0 0x0 0x1 0x1 0x1 0x68 0x1 0x0 0x0 0x1 0x1 0x1 0x69 0x1 0x0 0x0 0x1 0x1 0x1 0x6a 0x1 0x0 0x0 0x1 0x1 0x1 0x6b 0x1 0x0 0x0 0x1 0x1 0x1 0x6c 0x1 0x0 0x0 0x1 0x1 0x1 0x6d 0x1 0x0 0x0 0x1 0x1 0x1 0x6e 0x1 0x0 0x0 0x1 0x1 0x1 0x6f 0x1 0x0 0x0 0x1 0x1 0x1 0x70 0x1 0x0 0x0 0x1 0x1 0x1 0x71 0x1 0x0 0x0 0x1 0x1 0x1 0x72 0x1 0x0 0x0 0x1 0x1 0x1 0x73 0x1 0x0 0x0 0x1 0x0 0x1 0x74 0x1 0x0 0x0 0x1 0x0 0x1 0x75 0x0 0x0 0x0 0x1 0x0 0x1 0x76 0x0 0x0 0x0 0x1 0x0 0x1 0x77 0x1 0x0 0x0 0x0 0x0 0x1 0x78 0x1 0x0 0x0 0x0 0x0 0x1 0x79 0x1 0x0 0x0 0x1 0x1 0x1 0x7a 0x1 0x0 0x0 0x1 0x1 0x1 0x7b 0x1 0x0 0x0 0x0 0x0 0x1 0x7c 0x1 0x0 0x0 0x0 0x0 0x1 0x7d 0x1 0x0 0x0 0x0 0x0 0x1 0x7e 0x1 0x0 0x0 0x1 0x1 0x1 0x7f 0x1 0x0 0x0 0x1 0x1 0x1 0x80 0x1 0x0 0x0 0x1 0x1 0x1 0x81 0x1 0x0 0x0 0x1 0x1 0x1 0x82 0x1 0x0 0x0 0x1 0x1 0x1 0x83 0x0 0x1 0x0 0x1 0x0 0x1 0x84 0x0 0x1 0x0 0x1 0x0 0x1 0x85 0x0 0x1 0x0 0x1 0x0 0x1 0x86 0x0 0x1 0x0 0x1 0x0 0x1 0x87 0x0 0x1 0x0 0x1 0x0 0x1 0x88 0x0 0x1 0x0 0x1 0x0 0x1 0x89 0x0 0x1 0x0 0x1 0x0 0x1 0x8a 0x0 0x1 0x0 0x1 0x0 0x1 0x8b 0x0 0x1 0x0 0x1 0x0 0x1 0x8c 0x0 0x1 0x0 0x1 0x0 0x1 0x8d 0x1 0x0 0x0 0x1 0x1 0x1 0x8e 0x1 0x0 0x0 0x1 0x1 0x1 0x8f 0x1 0x0 0x0 0x0 0x0 0x1 0x90 0x1 0x0 0x0 0x0 0x0 0x1 0x91 0x1 0x0 0x0 0x0 0x0 0x1 0x92 0x1 0x0 0x0 0x0 0x0 0x1 0x93 0x1 0x0 0x0 0x0 0x0 0x1 0x94 0x1 0x0 0x0 0x0 0x0 0x1 0x95 0x1 0x0 0x0 0x1 0x0 0x1 0x96 0x1 0x0 0x0 0x1 0x0 0x1 0x97 0x1 0x0 0x0 0x1 0x0 0x1 0x98 0x1 0x0 0x0 0x1 0x0 0x1 0x99 0x1 0x0 0x0 0x0 0x0 0x1 0x9a 0x1 0x0 0x0 0x0 0x0 0x1 0x9b 0x1 0x0 0x0 0x0 0x0 0x1 0x9c 0x1 0x0 0x0 0x0 0x0 0x1 0x9d 0x1 0x0 0x0 0x0 0x0 0x1 0x9e 0x1 0x0 0x0 0x0 0x0 0x1 0x9f 0x1 0x0 0x0 0x1 0x0 0x1 0xa0 0x1 0x0 0x0 0x1 0x0 0x1 0xa1 0x1 0x0 0x0 0x1 0x0 0x1 0xa2 0x1 0x0 0x0 0x0 0x0 0x0 0xa3 0x1 0x0 0x0 0x1 0x0 0x0 0xa4 0x1 0x0 0x0 0x1 0x0 0x1 0xa5 0x1 0x0 0x0 0x1 0x0 0x1 0xa6 0x1 0x0 0x0 0x0 0x0 0x1 0xa7 0x1 0x0 0x0 0x0 0x0 0x1 0xa8 0x1 0x0 0x0 0x0 0x0 0x1 0xa9 0x0 0x0 0x0 0x1 0x0 0x1 0xaa 0x0 0x1 0x1 0x1 0x0 0x1 0xab 0x1 0x0 0x0 0x0 0x0 0x1 0xac 0x1 0x0 0x0 0x0 0x0 0x1 0xad 0x1 0x0 0x0 0x0 0x0 0x1 0xae 0x1 0x0 0x0 0x0 0x0 0x1 0xaf 0x1 0x0 0x0 0x0 0x0 0x1 0xb0 0x1 0x0 0x0 0x0 0x0 0x1 0xb1 0x1 0x0 0x0 0x0 0x0 0x1 0xb2 0x1 0x0 0x0 0x0 0x0 0x1 0xb3 0x1 0x0 0x0 0x0 0x0 0x1 0xb4 0x1 0x0 0x0 0x0 0x0 0x1 0xb5 0x1 0x0 0x0 0x0 0x0 0x1 0xb6 0x1 0x0 0x0 0x0 0x0 0x1 0xb7 0x1 0x0 0x0 0x0 0x0 0x1 0xb8 0x1 0x0 0x0 0x0 0x0 0x1 0xb9 0x1 0x0 0x0 0x0 0x0 0x1 0xba 0x1 0x0 0x0 0x0 0x0 0x1 0xbb 0x1 0x0 0x0 0x0 0x0 0x1 0xbc 0x1 0x0 0x0 0x0 0x0 0x0 0xbd 0x1 0x0 0x0 0x1 0x0 0x0 0xbe 0x1 0x0 0x0 0x0 0x0 0x0 0xbf 0x1 0x0 0x0 0x1 0x0 0x0 0xc0 0x0 0x0 0x0 0x1 0x0 0x1 0xc1 0x0 0x0 0x0 0x1 0x0 0x1 0xc2 0x0 0x0 0x0 0x1 0x0 0x1 0xc3 0x0 0x0 0x0 0x1 0x0 0x1 0xc4 0x0 0x0 0x0 0x1 0x0 0x1 0xc5 0x0 0x0 0x0 0x1 0x0 0x1 0xc6 0x0 0x0 0x0 0x1 0x0 0x1 0xc7 0x0 0x0 0x0 0x1 0x0 0x1 0xc8 0x0 0x0 0x0 0x1 0x0 0x1>;
		};
	};
	fragment@67 {
		target = <0xffffffff>;
		__overlay__ {
			interrupt-parent = <0xffffffff>;
			interrupts = <0x1 0x8>;
			deb-gpios = <0xffffffff 0x1 0x0>;
			debounce = <0x7d000>;
			status = "okay";
		};
	};
	fragment@68 {
		target = <0xffffffff>;
		__overlay__ {
			interrupt-parent = <0xffffffff>;
			interrupts = <0x4 0x4>;
			deb-gpios = <0xffffffff 0x4 0x0>;
			debounce = <0x186a0>;
			status = "okay";
		};
	};
	fragment@69 {
		target = <0xffffffff>;
		__overlay__ {
			interrupt-parent = <0xffffffff>;
			interrupts = <0xa 0x2>;
			status = "okay";
		};
	};
	fragment@70 {
		target = <0xffffffff>;
		__overlay__ {
			interrupt-parent = <0xffffffff>;
			interrupts = <0x54 0x1>;
			status = "okay";
		};
	};
	fragment@71 {
		target = <0xffffffff>;
		__overlay__ {
			compatible = "mediatek,md1_sim1_hot_plug_eint-eint";
			interrupts = <0x0 0x8>;
			debounce = <0x0 0xc350>;
			dedicated = <0x0 0x0>;
			src_pin = <0x0 0x1>;
			sockettype = <0x0 0x0>;
			status = "okay";
		};
	};
	fragment@72 {
		target = <0xffffffff>;
		__overlay__ {
			mediatek,kpd-key-debounce = <0x400>;
			mediatek,kpd-sw-pwrkey = <0x74>;
			mediatek,kpd-hw-pwrkey = <0x8>;
			mediatek,kpd-use-extend-type = <0x0>;
			mediatek,kpd-hw-map-num = <0x48>;
			mediatek,kpd-hw-init-map = <0x73 0x72 0x0 0x0 0x0 0x0 0x0 0x0 0x0 0x0 0x0 0x0 0x0 0x0 0x0 0x0 0x0 0x0 0x0 0x0 0x0 0x0 0x0 0x0 0x0 0x0 0x0 0x0 0x0 0x0 0x0 0x0 0x0 0x0 0x0 0x0 0x0 0x0 0x0 0x0 0x0 0x0 0x0 0x0 0x0 0x0 0x0 0x0 0x0 0x0 0x0 0x0 0x0 0x0 0x0 0x0 0x0 0x0 0x0 0x0 0x0 0x0 0x0 0x0 0x0 0x0 0x0 0x0 0x0 0x0 0x0 0x0>;
			mediatek,kpd-pwrkey-eint-gpio = <0x0>;
			mediatek,kpd-pwkey-gpio-din = <0x0>;
			mediatek,kpd-hw-dl-key0 = <0x0>;
			mediatek,kpd-hw-dl-key1 = <0x1>;
			mediatek,kpd-hw-dl-key2 = <0x8>;
			mediatek,kpd-hw-recovery-key = <0x0>;
			mediatek,kpd-hw-factory-key = <0x1>;
			status = "okay";
		};
	};
	__symbols__ {
		tran_audio_controller = "/fragment@5/__overlay__/tran_audio_controller";
		tran_audio = "/fragment@5/__overlay__/tran_audio";
		mtkfb_pins_lcm_rst_out1_gpio = "/fragment@6/__overlay__/lcm_rst_out1_gpio";
		mtkfb_pins_lcm_rst_out0_gpio = "/fragment@6/__overlay__/lcm_rst_out0_gpio";
		mtkfb_pins_lcm_dsi_te = "/fragment@6/__overlay__/lcm_dsi_te";
		mtkfb_pins_6382_rst_out1_gpio = "/fragment@6/__overlay__/6382_rst_out1_gpio";
		mtkfb_pins_6382_rst_out0_gpio = "/fragment@6/__overlay__/6382_rst_out0_gpio";
		panel_in1 = "/fragment@9/__overlay__/panel1@0/port/endpoint";
		dsi_out = "/fragment@9/__overlay__/ports/port/endpoint";
		irq_nfc = "/fragment@13/__overlay__/irq_nfc";
		spislv_pins_default = "/fragment@14/__overlay__/spislv_mode_default";
		kpd_pins_default = "/fragment@17/__overlay__/kpdgpiodefault";
		led0 = "/fragment@19/__overlay__/led@0";
		led1 = "/fragment@19/__overlay__/led@1";
		led2 = "/fragment@19/__overlay__/led@2";
		led3 = "/fragment@19/__overlay__/led@3";
		led4 = "/fragment@19/__overlay__/led@4";
		led5 = "/fragment@19/__overlay__/led@5";
		led6 = "/fragment@19/__overlay__/led@6";
		vibrator0 = "/fragment@19/__overlay__/vibrator@0";
		fingerprint = "/fragment@19/__overlay__/fingerprint";
		fingerprint_default = "/fragment@21/__overlay__/fingerprint_default";
		fingerprint_eint = "/fragment@21/__overlay__/gpio9_eint";
		fingerprint_eint_pull_down = "/fragment@21/__overlay__/gpio9_eint_pull_down";
		fingerprint_rst_one = "/fragment@21/__overlay__/rst_out_one";
		fingerprint_rst_zero = "/fragment@21/__overlay__/rst_out_zero";
		fingerprint_spi_default = "/fragment@21/__overlay__/spimode_default";
		gps_pins_default = "/fragment@22/__overlay__/gps_default";
		gps_l1_lna_pins_ol = "/fragment@22/__overlay__/gps_l1_lna@0";
		gps_l1_lna_pins_dsp_ctrl = "/fragment@22/__overlay__/gps_l1_lna@1";
		gps_l1_lna_pins_oh = "/fragment@22/__overlay__/gps_l1_lna@2";
		gps_l5_lna_pins_ol = "/fragment@22/__overlay__/gps_l5_lna@0";
		gps_l5_lna_pins_dsp_ctrl = "/fragment@22/__overlay__/gps_l5_lna@1";
		gps_l5_lna_pins_oh = "/fragment@22/__overlay__/gps_l5_lna@2";
		usb_control = "/fragment@24/__overlay__/usb_control";
		usb_control_default = "/fragment@25/__overlay__/usb_control_default";
		hvdcp_handshake = "/fragment@25/__overlay__/hvdcp_handshake";
		hvdcp_boost_5v = "/fragment@25/__overlay__/hvdcp_boost_5v";
		hvdcp_boost_9v = "/fragment@25/__overlay__/hvdcp_boost_9v";
		hvdcp_reset = "/fragment@25/__overlay__/hvdcp_reset";
		tc30_handshake = "/fragment@25/__overlay__/tc30_handshake";
		tc30_reset = "/fragment@25/__overlay__/tc30_reset";
		rfc_i2c_mode = "/fragment@25/__overlay__/rfc_i2c_mode";
		rfc_dual_high = "/fragment@25/__overlay__/rfc_dual_high";
		rfc_high_low = "/fragment@25/__overlay__/rfc_high_low";
		rfc_reset = "/fragment@25/__overlay__/rfc_reset";
		rfc_usb_switch_on = "/fragment@25/__overlay__/usb_switch_on";
		rfc_usb_switch_off = "/fragment@25/__overlay__/usb_switch_off";
		ta_off = "/fragment@25/__overlay__/ta_off";
		ta_reset = "/fragment@25/__overlay__/ta_reset";
		charge_transfer = "/fragment@26/__overlay__/charge_transfer";
		tran_otg = "/fragment@26/__overlay__/tran_otg";
		tc_audio = "/fragment@26/__overlay__/tc_audio";
		water_detect = "/fragment@26/__overlay__/water_detect";
		tc_chgtype = "/fragment@26/__overlay__/tc_chgtype";
		tc_pmic = "/fragment@26/__overlay__/tc_pmic";
		tc_gauge = "/fragment@26/__overlay__/tc_gauge";
		tc_misc = "/fragment@26/__overlay__/tc_misc";
		tc_lcd = "/fragment@26/__overlay__/tc_lcd";
		tc_pe2 = "/fragment@26/__overlay__/tc_pe2";
		tc_30 = "/fragment@26/__overlay__/tc_30";
		tc_hvdcp20 = "/fragment@26/__overlay__/tc_hvdcp20";
		tc_pd = "/fragment@26/__overlay__/tc_pd";
		tc_auto_test = "/fragment@26/__overlay__/tc_auto_test";
		pid_chg = "/fragment@26/__overlay__/pid_chg";
		ambient_detect = "/fragment@26/__overlay__/ambient_detect";
		temp_forecast = "/fragment@26/__overlay__/temp_forecast";
		pe5 = "/fragment@26/__overlay__/pe5";
		tc_tcpc = "/fragment@26/__overlay__/tc_tcpc";
		tc_adapter_control = "/fragment@26/__overlay__/tc_adapter_control";
		tc_pd_adapter = "/fragment@33/__overlay__/tc_pd_adapter";
		tfcp_i2c_sclk_mode = "/fragment@35/__overlay__/tfcp_i2c_sclk_mode";
		tfcp_i2c_sda_mode = "/fragment@35/__overlay__/tfcp_i2c_sda_mode";
		tc_led = "/fragment@38/__overlay__/tc_led";
		touch = "/fragment@42/__overlay__/touch";
		ctp_pins_default = "/fragment@44/__overlay__/ctp_default";
		ctp_pins_spi_mode = "/fragment@44/__overlay__/ctp_spimode_default";
		camera_pins_cam0_mclk_off = "/fragment@45/__overlay__/camera_pins_cam0_mclk_off";
		camera_pins_cam0_mclk_2ma = "/fragment@45/__overlay__/camera_pins_cam0_mclk_2ma";
		camera_pins_cam0_mclk_4ma = "/fragment@45/__overlay__/camera_pins_cam0_mclk_4ma";
		camera_pins_cam0_mclk_6ma = "/fragment@45/__overlay__/camera_pins_cam0_mclk_6ma";
		camera_pins_cam0_mclk_8ma = "/fragment@45/__overlay__/camera_pins_cam0_mclk_8ma";
		camera_pins_cam1_mclk_off = "/fragment@45/__overlay__/camera_pins_cam1_mclk_off";
		camera_pins_cam1_mclk_2ma = "/fragment@45/__overlay__/camera_pins_cam1_mclk_2ma";
		camera_pins_cam1_mclk_4ma = "/fragment@45/__overlay__/camera_pins_cam1_mclk_4ma";
		camera_pins_cam1_mclk_6ma = "/fragment@45/__overlay__/camera_pins_cam1_mclk_6ma";
		camera_pins_cam1_mclk_8ma = "/fragment@45/__overlay__/camera_pins_cam1_mclk_8ma";
		camera_pins_cam2_mclk_off = "/fragment@45/__overlay__/camera_pins_cam2_mclk_off";
		camera_pins_cam2_mclk_2ma = "/fragment@45/__overlay__/camera_pins_cam2_mclk_2ma";
		camera_pins_cam2_mclk_4ma = "/fragment@45/__overlay__/camera_pins_cam2_mclk_4ma";
		camera_pins_cam2_mclk_6ma = "/fragment@45/__overlay__/camera_pins_cam2_mclk_6ma";
		camera_pins_cam2_mclk_8ma = "/fragment@45/__overlay__/camera_pins_cam2_mclk_8ma";
		camera_pins_default = "/fragment@45/__overlay__/camdefault";
		mtk_camera_eeprom0 = "/fragment@47/__overlay__/camera-eeprom0@50";
		mtk_camera_eeprom1 = "/fragment@48/__overlay__/camera-eeprom1@51";
		ET5904LDO18 = "/fragment@49/__overlay__/et5904@28/regulators/ET5904LDO18";
		ET5904LDO28 = "/fragment@49/__overlay__/et5904@28/regulators/ET5904LDO28";
		ET5904LDO38 = "/fragment@49/__overlay__/et5904@28/regulators/ET5904LDO38";
		ET5904LDO48 = "/fragment@49/__overlay__/et5904@28/regulators/ET5904LDO48";
		flashlights_ocp81375 = "/fragment@50/__overlay__/flashlights_ocp81375";
		flashlights_aw36515 = "/fragment@50/__overlay__/flashlights_aw36515";
		vs2pmu = "/fragment@50/__overlay__/vs2pmu";
		ET5904LDO4EN = "/fragment@50/__overlay__/LDO4EN";
		cam0rst_gpio56 = "/fragment@50/__overlay__/cam0rst_gpio56";
		cam1pdn_gpio53 = "/fragment@50/__overlay__/cam1pdn_gpio53";
		cam1rst_gpio54 = "/fragment@50/__overlay__/cam0rst_gpio54";
		cam23avdd_gpio20 = "/fragment@50/__overlay__/cam23avdd_gpio20";
		cam2rst_gpio58 = "/fragment@50/__overlay__/cam2rst_gpio58";
		flashlight_gpio134 = "/fragment@50/__overlay__/flashlight_gpio134";
		flashlight_gpio40 = "/fragment@50/__overlay__/flashlight_gpio40";
		flashlight_gpio42 = "/fragment@50/__overlay__/flashlight_gpio42";
		camera_main_two_mtk = "/fragment@57/__overlay__/camera_main_two@10";
		nfc_mtk = "/fragment@58/__overlay__/nfc@28";
		camera_main_mtk = "/fragment@59/__overlay__/camera_main@1a";
		camera_main_af_mtk = "/fragment@59/__overlay__/camera_main_af@72";
		i2c_lcd_bias_mtk = "/fragment@61/__overlay__/i2c_lcd_bias@73";
		strobe_main_mtk = "/fragment@63/__overlay__/strobe_main@63";
		camera_sub_mtk = "/fragment@64/__overlay__/camera_sub@1a";
	};
	__fixups__ {
		chosen = "/fragment@0:target:0", "/fragment@26/__overlay__/water_detect:bootmode:0", "/fragment@26/__overlay__/tc_misc:bootmode:0", "/fragment@33/__overlay__/tc_pd_adapter:boot_mode:0", "/fragment@40:target:0";
		subpmic_mtk = "/fragment@1:target:0";
		pio = "/fragment@1/__overlay__:mt6360,intr_gpio:0", "/fragment@3/__overlay__:mt6360pd,intr-gpio:0", "/fragment@6:target:0", "/fragment@9/__overlay__:bdg-gpios:0", "/fragment@9/__overlay__/panel1@0:dvdd-gpios:0", "/fragment@9/__overlay__/panel1@0:vci-gpios:0", "/fragment@9/__overlay__/panel1@0:reset-gpios:0", "/fragment@10/__overlay__:ldo-gpio:0", "/fragment@13/__overlay__/nfc_nxp@28:nxp,pn544-irq:0", "/fragment@13/__overlay__/nfc_nxp@28:nxp,pn544-ven:0", "/fragment@13/__overlay__/irq_nfc:interrupt-parent:0", "/fragment@14:target:0", "/fragment@17:target:0", "/fragment@19/__overlay__/fingerprint:interrupt-parent:0", "/fragment@20/__overlay__/fingerprint@0:interrupt-parent:0", "/fragment@20/__overlay__/fingerprint@0:irq-gpio-std:0", "/fragment@20/__overlay__/fingerprint@0:reset-gpio-std:0", "/fragment@21:target:0", "/fragment@22:target:0", "/fragment@25:target:0", "/fragment@35:target:0", "/fragment@36/__overlay__/hl7138_master@55:hl7138,intr-gpios:0", "/fragment@37/__overlay__/hl7138_slave@55:hl7138,intr-gpios:0", "/fragment@39/__overlay__/aw20216_led@20:enable-gpio:0", "/fragment@41/__overlay__/fshaptic@34:reset-gpio:0", "/fragment@41/__overlay__/fshaptic@34:irq-gpio:0", "/fragment@42/__overlay__/touch:interrupt-parent:0", "/fragment@43/__overlay__/focaltech@0:focaltech,irq-gpio:0", "/fragment@43/__overlay__/focaltech@0:focaltech,reset-gpio:0", "/fragment@43/__overlay__/focaltech@0:focaltech,iovdd-gpio:0", "/fragment@44:target:0", "/fragment@45:target:0", "/fragment@46/__overlay__:camera_input_gpio:0", "/fragment@50/__overlay__/vs2pmu:gpio:0", "/fragment@50/__overlay__/LDO4EN:gpio:0", "/fragment@50/__overlay__/cam0rst_gpio56:gpio:0", "/fragment@50/__overlay__/cam1pdn_gpio53:gpio:0", "/fragment@50/__overlay__/cam0rst_gpio54:gpio:0", "/fragment@50/__overlay__/cam23avdd_gpio20:gpio:0", "/fragment@50/__overlay__/cam2rst_gpio58:gpio:0", "/fragment@50/__overlay__/flashlight_gpio134:gpio:0", "/fragment@50/__overlay__/flashlight_gpio40:gpio:0", "/fragment@50/__overlay__/flashlight_gpio42:gpio:0", "/fragment@65/__overlay__:GPIO_FDD_BAND_SUPPORT_DETECT_2ND_PIN:0", "/fragment@65/__overlay__:GPIO_FDD_BAND_SUPPORT_DETECT_3RD_PIN:0", "/fragment@65/__overlay__:GPIO_SIM1_HOT_PLUG:0", "/fragment@65/__overlay__:GPIO_SIM2_SCLK:0", "/fragment@65/__overlay__:GPIO_SIM2_SRST:0", "/fragment@65/__overlay__:GPIO_SIM2_SIO:0", "/fragment@65/__overlay__:GPIO_SIM1_SIO:0", "/fragment@65/__overlay__:GPIO_SIM1_SRST:0", "/fragment@65/__overlay__:GPIO_SIM1_SCLK:0", "/fragment@65/__overlay__:GPIO_RF_PWREN_RST_PIN:0", "/fragment@67/__overlay__:interrupt-parent:0", "/fragment@67/__overlay__:deb-gpios:0", "/fragment@68/__overlay__:interrupt-parent:0", "/fragment@68/__overlay__:deb-gpios:0", "/fragment@69/__overlay__:interrupt-parent:0", "/fragment@70/__overlay__:interrupt-parent:0";
		mt6360_regulator = "/fragment@2:target:0";
		mt6360_typec = "/fragment@3:target:0", "/fragment@30:target:0";
		i2c3 = "/fragment@4:target:0", "/fragment@13:target:0", "/fragment@58:target:0";
		odm = "/fragment@5:target:0", "/fragment@19:target:0", "/fragment@24:target:0", "/fragment@26:target:0", "/fragment@33:target:0", "/fragment@38:target:0", "/fragment@42:target:0", "/fragment@50:target:0";
		mtkfb = "/fragment@7:target:0";
		dispsys_config = "/fragment@8:target:0";
		dsi0 = "/fragment@9:target:0";
		irtx_pwm = "/fragment@10:target:0";
		mtk_leds = "/fragment@11:target:0";
		spi5 = "/fragment@12:target:0";
		bdg_support = "/fragment@15:target:0";
		keypad = "/fragment@16:target:0", "/fragment@72:target:0";
		accdet = "/fragment@18:target:0";
		spi0 = "/fragment@20:target:0";
		mt_pmic_vfp_ldo_reg = "/fragment@20/__overlay__/fingerprint@0:vmch-supply:0";
		gps = "/fragment@23:target:0";
		mt6360_chg = "/fragment@26/__overlay__/tc_chgtype:charger:0";
		u2port0 = "/fragment@26/__overlay__/tc_chgtype:phys:0", "/fragment@33/__overlay__/tc_pd_adapter:phys:0";
		usb = "/fragment@26/__overlay__/tc_chgtype:usb:0";
		mtk_gauge = "/fragment@26/__overlay__/tc_gauge:gauge:0", "/fragment@26/__overlay__/pe5:gauge:0", "/fragment@29:target:0";
		auxadc = "/fragment@26/__overlay__/tc_misc:io-channels:0", "/fragment@52:target:0", "/fragment@53/__overlay__:io-channels:0";
		charger = "/fragment@27:target:0";
		extcon_usb = "/fragment@28:target:0";
		battery_manager = "/fragment@31:target:0";
		lk_charger = "/fragment@32:target:0";
		i2c7 = "/fragment@34:target:0", "/fragment@36:target:0", "/fragment@62:target:0";
		i2c8 = "/fragment@37:target:0", "/fragment@41:target:0", "/fragment@49:target:0", "/fragment@63:target:0";
		i2c6 = "/fragment@39:target:0", "/fragment@61:target:0";
		spi4 = "/fragment@43:target:0";
		mt_pmic_vtp_ldo_reg = "/fragment@43/__overlay__/focaltech@0:vtouch-supply:0";
		kd_camera_hw1 = "/fragment@46:target:0";
		mt6359p_vcamio_reg = "/fragment@46/__overlay__:cam0_vcamio-supply:0", "/fragment@46/__overlay__:cam1_vcamio-supply:0", "/fragment@46/__overlay__:cam2_vcamio-supply:0";
		i2c4 = "/fragment@47:target:0", "/fragment@59:target:0";
		i2c9 = "/fragment@48:target:0", "/fragment@64:target:0";
		camera_af_hw_node = "/fragment@51:target:0";
		mt6359p_vio28_reg = "/fragment@51/__overlay__:camaf_m1_pmic-supply:0";
		md_auxadc = "/fragment@53:target:0";
		pmic_clock_buffer_ctrl = "/fragment@54:target:0";
		i2c0 = "/fragment@55:target:0";
		i2c1 = "/fragment@56:target:0";
		i2c2 = "/fragment@57:target:0";
		i2c5 = "/fragment@60:target:0";
		gpio_usage_mapping = "/fragment@65:target:0";
		gpio = "/fragment@66:target:0";
		mrdump_ext_rst = "/fragment@67:target:0";
		msdc1_ins = "/fragment@68:target:0";
		subpmic_pmu_eint = "/fragment@69:target:0";
		dsi_te = "/fragment@70:target:0";
		md1_sim1_hot_plug_eint = "/fragment@71:target:0";
	};
	__local_fixups__ {
		fragment@7 {
			__overlay__ {
				pinctrl-0 = <0x0>;
				pinctrl-1 = <0x0>;
				pinctrl-2 = <0x0>;
				pinctrl-3 = <0x0>;
				pinctrl-4 = <0x0>;
			};
		};
		fragment@8 {
			__overlay__ {
				pinctrl-0 = <0x0>;
				pinctrl-1 = <0x0>;
				pinctrl-2 = <0x0>;
			};
		};
		fragment@9 {
			__overlay__ {
				panel1@0 {
					port {
						endpoint {
							remote-endpoint = <0x0>;
						};
					};
				};
				ports {
					port {
						endpoint {
							remote-endpoint = <0x0>;
						};
					};
				};
			};
		};
		fragment@12 {
			__overlay__ {
				pinctrl-0 = <0x0>;
			};
		};
		fragment@16 {
			__overlay__ {
				pinctrl-0 = <0x0>;
			};
		};
		fragment@19 {
			__overlay__ {
				fingerprint {
					pinctrl-0 = <0x0>;
					pinctrl-1 = <0x0>;
					pinctrl-2 = <0x0>;
					pinctrl-3 = <0x0>;
					pinctrl-4 = <0x0>;
				};
			};
		};
		fragment@20 {
			__overlay__ {
				fingerprint@0 {
					pinctrl-0 = <0x0>;
					pinctrl-1 = <0x0>;
					pinctrl-2 = <0x0>;
					pinctrl-3 = <0x0>;
					pinctrl-4 = <0x0>;
					pinctrl-5 = <0x0>;
				};
			};
		};
		fragment@23 {
			__overlay__ {
				pinctrl-0 = <0x0>;
				pinctrl-1 = <0x0>;
				pinctrl-2 = <0x0>;
				pinctrl-3 = <0x0>;
				pinctrl-4 = <0x0>;
				pinctrl-5 = <0x0>;
				pinctrl-6 = <0x0>;
			};
		};
		fragment@24 {
			__overlay__ {
				usb_control {
					pinctrl-0 = <0x0>;
					pinctrl-1 = <0x0>;
					pinctrl-2 = <0x0>;
					pinctrl-3 = <0x0>;
					pinctrl-4 = <0x0>;
					pinctrl-5 = <0x0>;
					pinctrl-6 = <0x0>;
					pinctrl-7 = <0x0>;
					pinctrl-8 = <0x0>;
					pinctrl-9 = <0x0>;
					pinctrl-10 = <0x0>;
					pinctrl-11 = <0x0>;
					pinctrl-12 = <0x0>;
					pinctrl-13 = <0x0>;
					pinctrl-14 = <0x0>;
				};
			};
		};
		fragment@26 {
			__overlay__ {
				tc_audio {
					water_detect = <0x0>;
				};
				pe5 {
					tc_chgtype = <0x0>;
				};
			};
		};
		fragment@27 {
			__overlay__ {
				charger = <0x0>;
			};
		};
		fragment@28 {
			__overlay__ {
				charger = <0x0>;
			};
		};
		fragment@29 {
			__overlay__ {
				charger = <0x0>;
			};
		};
		fragment@30 {
			__overlay__ {
				charger = <0x0>;
			};
		};
		fragment@31 {
			__overlay__ {
				charger = <0x0>;
			};
		};
		fragment@34 {
			__overlay__ {
				tfcp_ta@1b {
					pinctrl-0 = <0x0>;
					pinctrl-1 = <0x0>;
				};
			};
		};
		fragment@43 {
			__overlay__ {
				focaltech@0 {
					pinctrl-0 = <0x0>;
					pinctrl-1 = <0x0>;
				};
			};
		};
		fragment@46 {
			__overlay__ {
				pinctrl-0 = <0x0>;
				pinctrl-1 = <0x0>;
				pinctrl-2 = <0x0>;
				pinctrl-3 = <0x0>;
				pinctrl-4 = <0x0>;
				pinctrl-5 = <0x0>;
				pinctrl-6 = <0x0>;
				pinctrl-7 = <0x0>;
				pinctrl-8 = <0x0>;
				pinctrl-9 = <0x0>;
				pinctrl-10 = <0x0>;
				pinctrl-11 = <0x0>;
				pinctrl-12 = <0x0>;
				pinctrl-13 = <0x0>;
				pinctrl-14 = <0x0>;
				pinctrl-15 = <0x0>;
				cam0_vcama-supply = <0x0>;
				cam0_vcamd-supply = <0x0>;
				cam0_vcamrst-supply = <0x0>;
				cam1_vcama-supply = <0x0>;
				cam1_vcamd-supply = <0x0>;
				cam1_vcamrst-supply = <0x0>;
				cam1_vcampdn-supply = <0x0>;
				cam2_vcama-supply = <0x0>;
				cam2_vcamrst-supply = <0x0>;
				cam3_vcama-supply = <0x0>;
			};
		};
		fragment@49 {
			__overlay__ {
				et5904@28 {
					VIND-supply = <0x0>;
				};
			};
		};
		fragment@50 {
			__overlay__ {
				flashlights_ocp81375 {
					ocp81375_regulator-supply = <0x0>;
					back-supply = <0x0>;
					front_warm-supply = <0x0>;
				};
				flashlights_aw36515 {
					aw36515_regulator-supply = <0x0>;
					back-supply = <0x0>;
					front_warm-supply = <0x0>;
				};
			};
		};
	};
};
